/******************************************************************************
* ASAP2 file: Controller_ValueDomain_TEST.a2l
* Academic License - for use in teaching, academic research, and meeting
* course requirements at degree granting institutions only. Not for
* government, commercial, or other organizational use.
* Code generation for model "Controller_ValueDomain_TEST".
* Model version : 1.82
* Simulink Coder version : 9.0 (R2018b) 24-May-2018
* C source code generated on : Tue Feb 15 09:06:24 2022
* Target selection: ert.tlc
* Embedded hardware selection: Generic->32-bit Embedded Processor
* Code generation objectives: Unspecified
* Validation result: Not run
* (add additional file header information here)
******************************************************************************/ ASAP2_VERSION 1 31
/* Version 1.31 */
/begin PROJECT ProjectName "Controller_ValueDomain_TEST_softwareID_v1_150222_090620"
/begin HEADER "Header Comments go here" /end HEADER
/begin MODULE ModuleName "Module Comment Goes Here"
/begin MOD_PAR "MOD PAR Comment Goes Here" ADDR_EPK 0x0800c00c CPU_TYPE "STM32F407" ECU "E407" EPK "Controller_ValueDomain_TEST_softwareID_v1_150222_090620"
 SYSTEM_CONSTANT "XcpStationID string length" "0x00000037"
 SYSTEM_CONSTANT "RAM-FlashOffset" "-402552672" /end MOD_PAR
/begin MOD_COMMON "Mod Common Comment Here" BYTE_ORDER MSB_LAST /end MOD_COMMON
/begin RECORD_LAYOUT Scalar_BOOLEAN FNC_VALUES 1 UBYTE COLUMN_DIR DIRECT /end RECORD_LAYOUT
/begin RECORD_LAYOUT Scalar_UBYTE FNC_VALUES 1 UBYTE COLUMN_DIR DIRECT /end RECORD_LAYOUT
/begin RECORD_LAYOUT Scalar_BYTE FNC_VALUES 1 SBYTE COLUMN_DIR DIRECT /end RECORD_LAYOUT
/begin RECORD_LAYOUT Scalar_UWORD FNC_VALUES 1 UWORD COLUMN_DIR DIRECT /end RECORD_LAYOUT
/begin RECORD_LAYOUT Scalar_SWORD FNC_VALUES 1 SWORD COLUMN_DIR DIRECT /end RECORD_LAYOUT
/begin RECORD_LAYOUT Scalar_ULONG FNC_VALUES 1 ULONG COLUMN_DIR DIRECT /end RECORD_LAYOUT
/begin RECORD_LAYOUT Scalar_LONG FNC_VALUES 1 SLONG COLUMN_DIR DIRECT /end RECORD_LAYOUT
/begin RECORD_LAYOUT Scalar_FLOAT32_IEEE FNC_VALUES 1 FLOAT32_IEEE COLUMN_DIR DIRECT /end RECORD_LAYOUT
/begin RECORD_LAYOUT Scalar_FLOAT64_IEEE FNC_VALUES 1 FLOAT64_IEEE COLUMN_DIR DIRECT /end RECORD_LAYOUT
/begin RECORD_LAYOUT Lookup1D_BYTE FNC_VALUES 1 SBYTE COLUMN_DIR DIRECT /end RECORD_LAYOUT
/begin RECORD_LAYOUT Lookup1D_X_BYTE AXIS_PTS_X 1 SBYTE INDEX_INCR DIRECT /end RECORD_LAYOUT
/begin RECORD_LAYOUT Lookup1D_UBYTE FNC_VALUES 1 UBYTE COLUMN_DIR DIRECT /end RECORD_LAYOUT
/begin RECORD_LAYOUT Lookup1D_X_UBYTE AXIS_PTS_X 1 UBYTE INDEX_INCR DIRECT /end RECORD_LAYOUT
/begin RECORD_LAYOUT Lookup1D_UWORD FNC_VALUES 1 UWORD COLUMN_DIR DIRECT /end RECORD_LAYOUT
/begin RECORD_LAYOUT Lookup1D_X_UWORD AXIS_PTS_X 1 UWORD INDEX_INCR DIRECT /end RECORD_LAYOUT
/begin RECORD_LAYOUT Lookup1D_WORD FNC_VALUES 1 SWORD COLUMN_DIR DIRECT /end RECORD_LAYOUT
/begin RECORD_LAYOUT Lookup1D_X_WORD AXIS_PTS_X 1 SWORD INDEX_INCR DIRECT /end RECORD_LAYOUT
/begin RECORD_LAYOUT Lookup1D_ULONG FNC_VALUES 1 ULONG COLUMN_DIR DIRECT /end RECORD_LAYOUT
/begin RECORD_LAYOUT Lookup1D_X_ULONG AXIS_PTS_X 1 ULONG INDEX_INCR DIRECT /end RECORD_LAYOUT
/begin RECORD_LAYOUT Lookup1D_SLONG FNC_VALUES 1 SLONG COLUMN_DIR DIRECT /end RECORD_LAYOUT
/begin RECORD_LAYOUT Lookup1D_X_LONG AXIS_PTS_X 1 SLONG INDEX_INCR DIRECT /end RECORD_LAYOUT
/begin RECORD_LAYOUT Lookup1D_FLOAT32_IEEE FNC_VALUES 1 FLOAT32_IEEE COLUMN_DIR DIRECT /end RECORD_LAYOUT
/begin RECORD_LAYOUT Lookup1D_X_FLOAT32_IEEE AXIS_PTS_X 1 FLOAT32_IEEE INDEX_INCR DIRECT /end RECORD_LAYOUT
/begin RECORD_LAYOUT Lookup1D_FLOAT64_IEEE FNC_VALUES 1 FLOAT64_IEEE COLUMN_DIR DIRECT /end RECORD_LAYOUT
/begin RECORD_LAYOUT Lookup1D_X_FLOAT64_IEEE AXIS_PTS_X 1 FLOAT64_IEEE INDEX_INCR DIRECT /end RECORD_LAYOUT
/begin RECORD_LAYOUT Lookup2D_UBYTE FNC_VALUES 1 UBYTE COLUMN_DIR DIRECT /end RECORD_LAYOUT
/begin RECORD_LAYOUT Lookup2D_X_UBYTE AXIS_PTS_X 1 UBYTE INDEX_INCR DIRECT /end RECORD_LAYOUT
/begin RECORD_LAYOUT Lookup2D_BYTE FNC_VALUES 1 SBYTE COLUMN_DIR DIRECT /end RECORD_LAYOUT
/begin RECORD_LAYOUT Lookup2D_X_BYTE AXIS_PTS_X 1 SBYTE INDEX_INCR DIRECT /end RECORD_LAYOUT
/begin RECORD_LAYOUT Lookup2D_UWORD FNC_VALUES 1 UWORD COLUMN_DIR DIRECT /end RECORD_LAYOUT
/begin RECORD_LAYOUT Lookup2D_X_UWORD AXIS_PTS_X 1 UWORD INDEX_INCR DIRECT /end RECORD_LAYOUT
/begin RECORD_LAYOUT Lookup2D_WORD FNC_VALUES 1 SWORD COLUMN_DIR DIRECT /end RECORD_LAYOUT
/begin RECORD_LAYOUT Lookup2D_X_WORD AXIS_PTS_X 1 SWORD INDEX_INCR DIRECT /end RECORD_LAYOUT
/begin RECORD_LAYOUT Lookup2D_ULONG FNC_VALUES 1 ULONG COLUMN_DIR DIRECT /end RECORD_LAYOUT
/begin RECORD_LAYOUT Lookup2D_X_ULONG AXIS_PTS_X 1 ULONG INDEX_INCR DIRECT /end RECORD_LAYOUT
/begin RECORD_LAYOUT Lookup2D_LONG FNC_VALUES 1 SLONG COLUMN_DIR DIRECT /end RECORD_LAYOUT
/begin RECORD_LAYOUT Lookup2D_X_LONG AXIS_PTS_X 1 SLONG INDEX_INCR DIRECT /end RECORD_LAYOUT
/begin RECORD_LAYOUT Lookup2D_FLOAT32_IEEE FNC_VALUES 1 FLOAT32_IEEE COLUMN_DIR DIRECT /end RECORD_LAYOUT
/begin RECORD_LAYOUT Lookup2D_X_FLOAT32_IEEE AXIS_PTS_X 1 FLOAT32_IEEE INDEX_INCR DIRECT /end RECORD_LAYOUT
/begin RECORD_LAYOUT Lookup2D_FLOAT64_IEEE FNC_VALUES 1 FLOAT64_IEEE COLUMN_DIR DIRECT /end RECORD_LAYOUT
/begin RECORD_LAYOUT Lookup2D_X_FLOAT64_IEEE AXIS_PTS_X 1 FLOAT64_IEEE INDEX_INCR DIRECT /end RECORD_LAYOUT
/begin CHARACTERISTIC delta_a_set "" VALUE 0x20000008 Scalar_FLOAT64_IEEE 0 Controller_ValueDomain_TEST_CM_double -1.7E+308 1.7E+308 /end CHARACTERISTIC
/begin CHARACTERISTIC delta_f_set "" VALUE 0x20000048 Scalar_FLOAT64_IEEE 0 Controller_ValueDomain_TEST_CM_double -1.7E+308 1.7E+308 /end CHARACTERISTIC
/begin CHARACTERISTIC speed_k_d "" VALUE 0x20000050 Scalar_FLOAT64_IEEE 0 Controller_ValueDomain_TEST_CM_double -1.7E+308 1.7E+308 /end CHARACTERISTIC
/begin CHARACTERISTIC speed_k_i "" VALUE 0x20000068 Scalar_FLOAT64_IEEE 0 Controller_ValueDomain_TEST_CM_double -1.7E+308 1.7E+308 /end CHARACTERISTIC
/begin CHARACTERISTIC speed_k_p "" VALUE 0x20000020 Scalar_FLOAT64_IEEE 0 Controller_ValueDomain_TEST_CM_double -1.7E+308 1.7E+308 /end CHARACTERISTIC
/begin CHARACTERISTIC torque_a_k_d "" VALUE 0x20000060 Scalar_FLOAT64_IEEE 0 Controller_ValueDomain_TEST_CM_double -1.7E+308 1.7E+308 /end CHARACTERISTIC
/begin CHARACTERISTIC torque_a_k_i "" VALUE 0x20000010 Scalar_FLOAT64_IEEE 0 Controller_ValueDomain_TEST_CM_double -1.7E+308 1.7E+308 /end CHARACTERISTIC
/begin CHARACTERISTIC torque_a_k_p "" VALUE 0x20000028 Scalar_FLOAT64_IEEE 0 Controller_ValueDomain_TEST_CM_double -1.7E+308 1.7E+308 /end CHARACTERISTIC
/begin CHARACTERISTIC torque_f_k_d "" VALUE 0x20000040 Scalar_FLOAT64_IEEE 0 Controller_ValueDomain_TEST_CM_double -1.7E+308 1.7E+308 /end CHARACTERISTIC
/begin CHARACTERISTIC torque_f_k_i "" VALUE 0x20000058 Scalar_FLOAT64_IEEE 0 Controller_ValueDomain_TEST_CM_double -1.7E+308 1.7E+308 /end CHARACTERISTIC
/begin CHARACTERISTIC torque_f_k_p "" VALUE 0x20000018 Scalar_FLOAT64_IEEE 0 Controller_ValueDomain_TEST_CM_double -1.7E+308 1.7E+308 /end CHARACTERISTIC
/begin CHARACTERISTIC v_set "" VALUE 0x20000038 Scalar_FLOAT64_IEEE 0 Controller_ValueDomain_TEST_CM_double -1.7E+308 1.7E+308 /end CHARACTERISTIC
/begin CHARACTERISTIC HANtuneOverride "" VALUE 0x20000030 Scalar_BOOLEAN 0 Controller_ValueDomain_TEST_CM_boolean 0 1 /end CHARACTERISTIC
/begin MEASUREMENT LT_s "" FLOAT64_IEEE Controller_ValueDomain_TEST_CM_double 0 0 -1.7E+308 1.7E+308 ECU_ADDRESS 0x2000b610 /end MEASUREMENT
/begin MEASUREMENT simulation_time "" FLOAT64_IEEE Controller_ValueDomain_TEST_CM_double 0 0 -1.7E+308 1.7E+308 ECU_ADDRESS 0x2000b880 /end MEASUREMENT
/begin MEASUREMENT theta_fr_s "" FLOAT64_IEEE Controller_ValueDomain_TEST_CM_double 0 0 -1.7E+308 1.7E+308 ECU_ADDRESS 0x2000b8b0 /end MEASUREMENT
/begin MEASUREMENT theta_fl_s "" FLOAT64_IEEE Controller_ValueDomain_TEST_CM_double 0 0 -1.7E+308 1.7E+308 ECU_ADDRESS 0x2000b600 /end MEASUREMENT
/begin MEASUREMENT theta_ar_s "" FLOAT64_IEEE Controller_ValueDomain_TEST_CM_double 0 0 -1.7E+308 1.7E+308 ECU_ADDRESS 0x2000b8d0 /end MEASUREMENT
/begin MEASUREMENT theta_al_s "" FLOAT64_IEEE Controller_ValueDomain_TEST_CM_double 0 0 -1.7E+308 1.7E+308 ECU_ADDRESS 0x2000b868 /end MEASUREMENT
/begin MEASUREMENT rx_data_time_s "" FLOAT64_IEEE Controller_ValueDomain_TEST_CM_double 0 0 -1.7E+308 1.7E+308 ECU_ADDRESS 0x2000b870 /end MEASUREMENT
/begin MEASUREMENT theta_fr_stored_s "" FLOAT64_IEEE Controller_ValueDomain_TEST_CM_double 0 0 -1.7E+308 1.7E+308 ECU_ADDRESS 0x2000b8c0 /end MEASUREMENT
/begin MEASUREMENT theta_fl_stored_s "" FLOAT64_IEEE Controller_ValueDomain_TEST_CM_double 0 0 -1.7E+308 1.7E+308 ECU_ADDRESS 0x2000b818 /end MEASUREMENT
/begin MEASUREMENT delta_dot_f_s "" FLOAT64_IEEE Controller_ValueDomain_TEST_CM_double 0 0 -1.7E+308 1.7E+308 ECU_ADDRESS 0x2000b5f0 /end MEASUREMENT
/begin MEASUREMENT theta_ar_stored_s "" FLOAT64_IEEE Controller_ValueDomain_TEST_CM_double 0 0 -1.7E+308 1.7E+308 ECU_ADDRESS 0x2000b8b8 /end MEASUREMENT
/begin MEASUREMENT theta_al_stored_s "" FLOAT64_IEEE Controller_ValueDomain_TEST_CM_double 0 0 -1.7E+308 1.7E+308 ECU_ADDRESS 0x2000b858 /end MEASUREMENT
/begin MEASUREMENT delta_dot_a_s "" FLOAT64_IEEE Controller_ValueDomain_TEST_CM_double 0 0 -1.7E+308 1.7E+308 ECU_ADDRESS 0x2000b810 /end MEASUREMENT
/begin MEASUREMENT delta_f_est_current_s "" FLOAT64_IEEE Controller_ValueDomain_TEST_CM_double 0 0 -1.7E+308 1.7E+308 ECU_ADDRESS 0x2000b8a0 /end MEASUREMENT
/begin MEASUREMENT delta_dot_f_prev_s "" FLOAT64_IEEE Controller_ValueDomain_TEST_CM_double 0 0 -1.7E+308 1.7E+308 ECU_ADDRESS 0x2000b828 /end MEASUREMENT
/begin MEASUREMENT rx_data_t_steerF_s "" FLOAT64_IEEE Controller_ValueDomain_TEST_CM_double 0 0 -1.7E+308 1.7E+308 ECU_ADDRESS 0x2000b800 /end MEASUREMENT
/begin MEASUREMENT rx_data_prev_t_steerF_s "" FLOAT64_IEEE Controller_ValueDomain_TEST_CM_double 0 0 -1.7E+308 1.7E+308 ECU_ADDRESS 0x2000b8e8 /end MEASUREMENT
/begin MEASUREMENT delta_f_est_s "" FLOAT64_IEEE Controller_ValueDomain_TEST_CM_double 0 0 -1.7E+308 1.7E+308 ECU_ADDRESS 0x2000b840 /end MEASUREMENT
/begin MEASUREMENT delta_a_est_current_s "" FLOAT64_IEEE Controller_ValueDomain_TEST_CM_double 0 0 -1.7E+308 1.7E+308 ECU_ADDRESS 0x2000b830 /end MEASUREMENT
/begin MEASUREMENT delta_dot_a_prev_s "" FLOAT64_IEEE Controller_ValueDomain_TEST_CM_double 0 0 -1.7E+308 1.7E+308 ECU_ADDRESS 0x2000b820 /end MEASUREMENT
/begin MEASUREMENT rx_data_t_steerA_s "" FLOAT64_IEEE Controller_ValueDomain_TEST_CM_double 0 0 -1.7E+308 1.7E+308 ECU_ADDRESS 0x2000b608 /end MEASUREMENT
/begin MEASUREMENT rx_data_prev_t_steerA_s "" FLOAT64_IEEE Controller_ValueDomain_TEST_CM_double 0 0 -1.7E+308 1.7E+308 ECU_ADDRESS 0x2000b8e0 /end MEASUREMENT
/begin MEASUREMENT delta_a_est_s "" FLOAT64_IEEE Controller_ValueDomain_TEST_CM_double 0 0 -1.7E+308 1.7E+308 ECU_ADDRESS 0x2000b848 /end MEASUREMENT
/begin MEASUREMENT v_est_s "" FLOAT64_IEEE Controller_ValueDomain_TEST_CM_double 0 0 -1.7E+308 1.7E+308 ECU_ADDRESS 0x2000b878 /end MEASUREMENT
/begin MEASUREMENT v_integral_s "" FLOAT64_IEEE Controller_ValueDomain_TEST_CM_double 0 0 -1.7E+308 1.7E+308 ECU_ADDRESS 0x2000b5f8 /end MEASUREMENT
/begin MEASUREMENT v_ctreff_s "" FLOAT64_IEEE Controller_ValueDomain_TEST_CM_double 0 0 -1.7E+308 1.7E+308 ECU_ADDRESS 0x2000b890 /end MEASUREMENT
/begin MEASUREMENT torque_fr_set_s "" FLOAT64_IEEE Controller_ValueDomain_TEST_CM_double 0 0 -1.7E+308 1.7E+308 ECU_ADDRESS 0x2000b888 /end MEASUREMENT
/begin MEASUREMENT torque_fl_set_s "" FLOAT64_IEEE Controller_ValueDomain_TEST_CM_double 0 0 -1.7E+308 1.7E+308 ECU_ADDRESS 0x2000b808 /end MEASUREMENT
/begin MEASUREMENT torque_ar_set_s "" FLOAT64_IEEE Controller_ValueDomain_TEST_CM_double 0 0 -1.7E+308 1.7E+308 ECU_ADDRESS 0x2000b860 /end MEASUREMENT
/begin MEASUREMENT torque_al_set_s "" FLOAT64_IEEE Controller_ValueDomain_TEST_CM_double 0 0 -1.7E+308 1.7E+308 ECU_ADDRESS 0x2000b8c8 /end MEASUREMENT
/begin MEASUREMENT SI_FreeHeap "" ULONG Controller_ValueDomain_TEST_CM_uint32 0 0 0 4294967295 ECU_ADDRESS 0x2000b838 /end MEASUREMENT
/begin MEASUREMENT SI_FreeStack "" ULONG Controller_ValueDomain_TEST_CM_uint32 0 0 0 4294967295 ECU_ADDRESS 0x2000b898 /end MEASUREMENT
/begin MEASUREMENT SI_CPUload "" UBYTE Controller_ValueDomain_TEST_CM_uint8 0 0 0 255 ECU_ADDRESS 0x2000b8d8 /end MEASUREMENT
/begin MEASUREMENT LedValue "" UBYTE Controller_ValueDomain_TEST_CM_boolean 0 0 0 1 ECU_ADDRESS 0x2000b850 /end MEASUREMENT
/begin COMPU_METHOD Controller_ValueDomain_TEST_CM_double "Q = V" RAT_FUNC "%15.10" "" COEFFS 0 1 0 0 0 1 /end COMPU_METHOD
/begin COMPU_METHOD Controller_ValueDomain_TEST_CM_boolean "Q = V" RAT_FUNC "%1.0" "" COEFFS 0 1 0 0 0 1 /end COMPU_METHOD
/begin COMPU_METHOD Controller_ValueDomain_TEST_CM_uint32 "Q = V" RAT_FUNC "%10.0" "" COEFFS 0 1 0 0 0 1 /end COMPU_METHOD
/begin COMPU_METHOD Controller_ValueDomain_TEST_CM_uint8 "Q = V" RAT_FUNC "%3.0" "" COEFFS 0 1 0 0 0 1 /end COMPU_METHOD
/begin GROUP Controller_ValueDomain_TEST "Controller_ValueDomain_TEST" /* Root */ ROOT /begin SUB_GROUP Root_HANcoder_STM32_Target___E407_STM32_algorithm /end SUB_GROUP /end GROUP
/begin GROUP Root_HANcoder_STM32_Target___E407_STM32_algorithm "Controller_ValueDomain_TEST/HANcoder STM32 Target - E407-STM32 algorithm"
 /begin SUB_GROUP S1_Algorithm S1_System_information S1_TTA_Controller_Value_Domain /end SUB_GROUP
/end GROUP
/begin GROUP S1_Algorithm "Controller_ValueDomain_TEST/HANcoder STM32 Target - E407-STM32 algorithm/Algorithm" /begin REF_CHARACTERISTIC HANtuneOverride /end REF_CHARACTERISTIC /begin REF_MEASUREMENT LedValue /end REF_MEASUREMENT /end GROUP
/begin GROUP S1_System_information "Controller_ValueDomain_TEST/HANcoder STM32 Target - E407-STM32 algorithm/System information" /begin SUB_GROUP S7_Get_CPU_load S7_Get_free_Heap S7_Get_free_Stack /end SUB_GROUP /end GROUP
/begin GROUP S1_TTA_Controller_Value_Domain "Controller_ValueDomain_TEST/HANcoder STM32 Target - E407-STM32 algorithm/TTA Controller Value Domain"
 /begin SUB_GROUP S8_Calculate_speed S8_Calculate_steering S8_Calculate_torque S8_Rx_Sensor_Values S8_Rx_Set_Values S8_Vehicle_emulator /end SUB_GROUP
 /begin REF_MEASUREMENT LT_s simulation_time /end REF_MEASUREMENT
/end GROUP
/begin GROUP S7_Get_CPU_load "Controller_ValueDomain_TEST/HANcoder STM32 Target - E407-STM32 algorithm/System information/Get CPU load" /begin REF_MEASUREMENT SI_CPUload /end REF_MEASUREMENT /end GROUP
/begin GROUP S7_Get_free_Heap "Controller_ValueDomain_TEST/HANcoder STM32 Target - E407-STM32 algorithm/System information/Get free Heap" /begin REF_MEASUREMENT SI_FreeHeap /end REF_MEASUREMENT /end GROUP
/begin GROUP S7_Get_free_Stack "Controller_ValueDomain_TEST/HANcoder STM32 Target - E407-STM32 algorithm/System information/Get free Stack" /begin REF_MEASUREMENT SI_FreeStack /end REF_MEASUREMENT /end GROUP
/begin GROUP S8_Calculate_speed "Controller_ValueDomain_TEST/HANcoder STM32 Target - E407-STM32 algorithm/TTA Controller Value Domain/Calculate speed" /begin SUB_GROUP S22_Integral_speed /end SUB_GROUP /begin REF_CHARACTERISTIC speed_k_d speed_k_i speed_k_p /end REF_CHARACTERISTIC
 /begin REF_MEASUREMENT torque_al_set_s torque_ar_set_s torque_fl_set_s torque_fr_set_s v_ctreff_s v_est_s /end REF_MEASUREMENT
/end GROUP
/begin GROUP S8_Calculate_steering "Controller_ValueDomain_TEST/HANcoder STM32 Target - E407-STM32 algorithm/TTA Controller Value Domain/Calculate steering" /begin SUB_GROUP S23_Integral_delta_a_est S23_Integral_delta_f_est /end SUB_GROUP
 /begin REF_MEASUREMENT delta_a_est_current_s delta_dot_a_prev_s delta_dot_a_s delta_dot_f_prev_s delta_dot_f_s delta_f_est_current_s rx_data_prev_t_steerA_s rx_data_prev_t_steerF_s rx_data_t_steerA_s rx_data_t_steerF_s theta_al_stored_s theta_ar_stored_s theta_fl_stored_s theta_fr_stored_s /end REF_MEASUREMENT
/end GROUP
/begin GROUP S8_Calculate_torque "Controller_ValueDomain_TEST/HANcoder STM32 Target - E407-STM32 algorithm/TTA Controller Value Domain/Calculate torque"
 /begin REF_CHARACTERISTIC torque_a_k_d torque_a_k_i torque_a_k_p torque_f_k_d torque_f_k_i torque_f_k_p /end REF_CHARACTERISTIC
/end GROUP
/begin GROUP S8_Rx_Sensor_Values "Controller_ValueDomain_TEST/HANcoder STM32 Target - E407-STM32 algorithm/TTA Controller Value Domain/Rx_Sensor_Values" /begin REF_MEASUREMENT rx_data_time_s /end REF_MEASUREMENT /end GROUP
/begin GROUP S8_Rx_Set_Values "Controller_ValueDomain_TEST/HANcoder STM32 Target - E407-STM32 algorithm/TTA Controller Value Domain/Rx_Set_Values" /begin REF_CHARACTERISTIC delta_a_set delta_f_set v_set /end REF_CHARACTERISTIC /end GROUP
/begin GROUP S8_Vehicle_emulator "Controller_ValueDomain_TEST/HANcoder STM32 Target - E407-STM32 algorithm/TTA Controller Value Domain/Vehicle emulator"
 /begin SUB_GROUP S29_Integral_theta_aft_left S29_Integral_theta_aft_right S29_Integral_theta_front_left S29_Integral_theta_front_right /end SUB_GROUP
/end GROUP
/begin GROUP S22_Integral_speed "Controller_ValueDomain_TEST/HANcoder STM32 Target - E407-STM32 algorithm/TTA Controller Value Domain/Calculate speed/Integral speed" /begin REF_MEASUREMENT v_integral_s /end REF_MEASUREMENT /end GROUP
/begin GROUP S23_Integral_delta_a_est "Controller_ValueDomain_TEST/HANcoder STM32 Target - E407-STM32 algorithm/TTA Controller Value Domain/Calculate steering/Integral_delta_a_est" /begin REF_MEASUREMENT delta_a_est_s /end REF_MEASUREMENT /end GROUP
/begin GROUP S23_Integral_delta_f_est "Controller_ValueDomain_TEST/HANcoder STM32 Target - E407-STM32 algorithm/TTA Controller Value Domain/Calculate steering/Integral_delta_f_est" /begin REF_MEASUREMENT delta_f_est_s /end REF_MEASUREMENT /end GROUP
/begin GROUP S29_Integral_theta_aft_left "Controller_ValueDomain_TEST/HANcoder STM32 Target - E407-STM32 algorithm/TTA Controller Value Domain/Vehicle emulator/Integral theta aft left" /begin REF_MEASUREMENT theta_al_s /end REF_MEASUREMENT /end GROUP
/begin GROUP S29_Integral_theta_aft_right "Controller_ValueDomain_TEST/HANcoder STM32 Target - E407-STM32 algorithm/TTA Controller Value Domain/Vehicle emulator/Integral theta aft right" /begin REF_MEASUREMENT theta_ar_s /end REF_MEASUREMENT /end GROUP
/begin GROUP S29_Integral_theta_front_left "Controller_ValueDomain_TEST/HANcoder STM32 Target - E407-STM32 algorithm/TTA Controller Value Domain/Vehicle emulator/Integral theta front left" /begin REF_MEASUREMENT theta_fl_s /end REF_MEASUREMENT /end GROUP
/begin GROUP S29_Integral_theta_front_right "Controller_ValueDomain_TEST/HANcoder STM32 Target - E407-STM32 algorithm/TTA Controller Value Domain/Vehicle emulator/Integral theta front right" /begin REF_MEASUREMENT theta_fr_s /end REF_MEASUREMENT /end GROUP
/end MODULE
/end PROJECT
/* (add any file trailer comments here) */
/* EOF Controller_ValueDomain_TEST.a2l */

/******************************************************************************
* ASAP2 file: HANcoder_E407_TTA_Controller_v4_5.a2l
* Academic License - for use in teaching, academic research, and meeting
* course requirements at degree granting institutions only. Not for
* government, commercial, or other organizational use.
* Code generation for model "HANcoder_E407_TTA_Controller_v4_5".
* Model version : 1.175
* Simulink Coder version : 9.0 (R2018b) 24-May-2018
* C source code generated on : Wed Jun 8 13:53:55 2022
* Target selection: ert.tlc
* Embedded hardware selection: ARM Compatible->ARM Cortex
* Code generation objectives: Unspecified
* Validation result: Not run
* (add additional file header information here)
******************************************************************************/ ASAP2_VERSION 1 31
/* Version 1.31 */
/begin PROJECT ProjectName "HANcoder_E407_TTA_Controller_v4_5_softwareID_v1_080622_135255"
/begin HEADER "Header Comments go here" /end HEADER
/begin MODULE ModuleName "Module Comment Goes Here"
/begin MOD_PAR "MOD PAR Comment Goes Here" ADDR_EPK 0x0800d12c CPU_TYPE "STM32F407" ECU "E407" EPK "HANcoder_E407_TTA_Controller_v4_5_softwareID_v1_080622_135255"
 SYSTEM_CONSTANT "XcpStationID string length" "0x0000003d"
 SYSTEM_CONSTANT "RAM-FlashOffset" "-402466592" /end MOD_PAR
/begin MOD_COMMON "Mod Common Comment Here" BYTE_ORDER MSB_LAST /end MOD_COMMON
/begin RECORD_LAYOUT Scalar_BOOLEAN FNC_VALUES 1 UBYTE COLUMN_DIR DIRECT /end RECORD_LAYOUT
/begin RECORD_LAYOUT Scalar_UBYTE FNC_VALUES 1 UBYTE COLUMN_DIR DIRECT /end RECORD_LAYOUT
/begin RECORD_LAYOUT Scalar_BYTE FNC_VALUES 1 SBYTE COLUMN_DIR DIRECT /end RECORD_LAYOUT
/begin RECORD_LAYOUT Scalar_UWORD FNC_VALUES 1 UWORD COLUMN_DIR DIRECT /end RECORD_LAYOUT
/begin RECORD_LAYOUT Scalar_SWORD FNC_VALUES 1 SWORD COLUMN_DIR DIRECT /end RECORD_LAYOUT
/begin RECORD_LAYOUT Scalar_ULONG FNC_VALUES 1 ULONG COLUMN_DIR DIRECT /end RECORD_LAYOUT
/begin RECORD_LAYOUT Scalar_LONG FNC_VALUES 1 SLONG COLUMN_DIR DIRECT /end RECORD_LAYOUT
/begin RECORD_LAYOUT Scalar_FLOAT32_IEEE FNC_VALUES 1 FLOAT32_IEEE COLUMN_DIR DIRECT /end RECORD_LAYOUT
/begin RECORD_LAYOUT Scalar_FLOAT64_IEEE FNC_VALUES 1 FLOAT64_IEEE COLUMN_DIR DIRECT /end RECORD_LAYOUT
/begin RECORD_LAYOUT Lookup1D_BYTE FNC_VALUES 1 SBYTE COLUMN_DIR DIRECT /end RECORD_LAYOUT
/begin RECORD_LAYOUT Lookup1D_X_BYTE AXIS_PTS_X 1 SBYTE INDEX_INCR DIRECT /end RECORD_LAYOUT
/begin RECORD_LAYOUT Lookup1D_UBYTE FNC_VALUES 1 UBYTE COLUMN_DIR DIRECT /end RECORD_LAYOUT
/begin RECORD_LAYOUT Lookup1D_X_UBYTE AXIS_PTS_X 1 UBYTE INDEX_INCR DIRECT /end RECORD_LAYOUT
/begin RECORD_LAYOUT Lookup1D_UWORD FNC_VALUES 1 UWORD COLUMN_DIR DIRECT /end RECORD_LAYOUT
/begin RECORD_LAYOUT Lookup1D_X_UWORD AXIS_PTS_X 1 UWORD INDEX_INCR DIRECT /end RECORD_LAYOUT
/begin RECORD_LAYOUT Lookup1D_WORD FNC_VALUES 1 SWORD COLUMN_DIR DIRECT /end RECORD_LAYOUT
/begin RECORD_LAYOUT Lookup1D_X_WORD AXIS_PTS_X 1 SWORD INDEX_INCR DIRECT /end RECORD_LAYOUT
/begin RECORD_LAYOUT Lookup1D_ULONG FNC_VALUES 1 ULONG COLUMN_DIR DIRECT /end RECORD_LAYOUT
/begin RECORD_LAYOUT Lookup1D_X_ULONG AXIS_PTS_X 1 ULONG INDEX_INCR DIRECT /end RECORD_LAYOUT
/begin RECORD_LAYOUT Lookup1D_SLONG FNC_VALUES 1 SLONG COLUMN_DIR DIRECT /end RECORD_LAYOUT
/begin RECORD_LAYOUT Lookup1D_X_LONG AXIS_PTS_X 1 SLONG INDEX_INCR DIRECT /end RECORD_LAYOUT
/begin RECORD_LAYOUT Lookup1D_FLOAT32_IEEE FNC_VALUES 1 FLOAT32_IEEE COLUMN_DIR DIRECT /end RECORD_LAYOUT
/begin RECORD_LAYOUT Lookup1D_X_FLOAT32_IEEE AXIS_PTS_X 1 FLOAT32_IEEE INDEX_INCR DIRECT /end RECORD_LAYOUT
/begin RECORD_LAYOUT Lookup1D_FLOAT64_IEEE FNC_VALUES 1 FLOAT64_IEEE COLUMN_DIR DIRECT /end RECORD_LAYOUT
/begin RECORD_LAYOUT Lookup1D_X_FLOAT64_IEEE AXIS_PTS_X 1 FLOAT64_IEEE INDEX_INCR DIRECT /end RECORD_LAYOUT
/begin RECORD_LAYOUT Lookup2D_UBYTE FNC_VALUES 1 UBYTE COLUMN_DIR DIRECT /end RECORD_LAYOUT
/begin RECORD_LAYOUT Lookup2D_X_UBYTE AXIS_PTS_X 1 UBYTE INDEX_INCR DIRECT /end RECORD_LAYOUT
/begin RECORD_LAYOUT Lookup2D_BYTE FNC_VALUES 1 SBYTE COLUMN_DIR DIRECT /end RECORD_LAYOUT
/begin RECORD_LAYOUT Lookup2D_X_BYTE AXIS_PTS_X 1 SBYTE INDEX_INCR DIRECT /end RECORD_LAYOUT
/begin RECORD_LAYOUT Lookup2D_UWORD FNC_VALUES 1 UWORD COLUMN_DIR DIRECT /end RECORD_LAYOUT
/begin RECORD_LAYOUT Lookup2D_X_UWORD AXIS_PTS_X 1 UWORD INDEX_INCR DIRECT /end RECORD_LAYOUT
/begin RECORD_LAYOUT Lookup2D_WORD FNC_VALUES 1 SWORD COLUMN_DIR DIRECT /end RECORD_LAYOUT
/begin RECORD_LAYOUT Lookup2D_X_WORD AXIS_PTS_X 1 SWORD INDEX_INCR DIRECT /end RECORD_LAYOUT
/begin RECORD_LAYOUT Lookup2D_ULONG FNC_VALUES 1 ULONG COLUMN_DIR DIRECT /end RECORD_LAYOUT
/begin RECORD_LAYOUT Lookup2D_X_ULONG AXIS_PTS_X 1 ULONG INDEX_INCR DIRECT /end RECORD_LAYOUT
/begin RECORD_LAYOUT Lookup2D_LONG FNC_VALUES 1 SLONG COLUMN_DIR DIRECT /end RECORD_LAYOUT
/begin RECORD_LAYOUT Lookup2D_X_LONG AXIS_PTS_X 1 SLONG INDEX_INCR DIRECT /end RECORD_LAYOUT
/begin RECORD_LAYOUT Lookup2D_FLOAT32_IEEE FNC_VALUES 1 FLOAT32_IEEE COLUMN_DIR DIRECT /end RECORD_LAYOUT
/begin RECORD_LAYOUT Lookup2D_X_FLOAT32_IEEE AXIS_PTS_X 1 FLOAT32_IEEE INDEX_INCR DIRECT /end RECORD_LAYOUT
/begin RECORD_LAYOUT Lookup2D_FLOAT64_IEEE FNC_VALUES 1 FLOAT64_IEEE COLUMN_DIR DIRECT /end RECORD_LAYOUT
/begin RECORD_LAYOUT Lookup2D_X_FLOAT64_IEEE AXIS_PTS_X 1 FLOAT64_IEEE INDEX_INCR DIRECT /end RECORD_LAYOUT
/begin CHARACTERISTIC COMM_Phase1 "" VALUE 0x20000060 Scalar_FLOAT64_IEEE 0 HANcoder_E407_TTA_Controller_v4_5_CM_double -1.7E+308 1.7E+308 /end CHARACTERISTIC
/begin CHARACTERISTIC COMM_Phase2 "" VALUE 0x20000068 Scalar_FLOAT64_IEEE 0 HANcoder_E407_TTA_Controller_v4_5_CM_double -1.7E+308 1.7E+308 /end CHARACTERISTIC
/begin CHARACTERISTIC COMM_Phase_init1 "" VALUE 0x20000078 Scalar_FLOAT64_IEEE 0 HANcoder_E407_TTA_Controller_v4_5_CM_double -1.7E+308 1.7E+308 /end CHARACTERISTIC
/begin CHARACTERISTIC COMM_Phase_init2 "" VALUE 0x20000080 Scalar_FLOAT64_IEEE 0 HANcoder_E407_TTA_Controller_v4_5_CM_double -1.7E+308 1.7E+308 /end CHARACTERISTIC
/begin CHARACTERISTIC delta_a_set "" VALUE 0x20000088 Scalar_FLOAT64_IEEE 0 HANcoder_E407_TTA_Controller_v4_5_CM_double -1.7E+308 1.7E+308 /end CHARACTERISTIC
/begin CHARACTERISTIC delta_f_set "" VALUE 0x20000008 Scalar_FLOAT64_IEEE 0 HANcoder_E407_TTA_Controller_v4_5_CM_double -1.7E+308 1.7E+308 /end CHARACTERISTIC
/begin CHARACTERISTIC script_run "" VALUE 0x20000090 Scalar_FLOAT64_IEEE 0 HANcoder_E407_TTA_Controller_v4_5_CM_double -1.7E+308 1.7E+308 /end CHARACTERISTIC
/begin CHARACTERISTIC speed_k_d "" VALUE 0x20000050 Scalar_FLOAT64_IEEE 0 HANcoder_E407_TTA_Controller_v4_5_CM_double -1.7E+308 1.7E+308 /end CHARACTERISTIC
/begin CHARACTERISTIC speed_k_i "" VALUE 0x20000058 Scalar_FLOAT64_IEEE 0 HANcoder_E407_TTA_Controller_v4_5_CM_double -1.7E+308 1.7E+308 /end CHARACTERISTIC
/begin CHARACTERISTIC speed_k_p "" VALUE 0x20000070 Scalar_FLOAT64_IEEE 0 HANcoder_E407_TTA_Controller_v4_5_CM_double -1.7E+308 1.7E+308 /end CHARACTERISTIC
/begin CHARACTERISTIC torque_a_k_d "" VALUE 0x20000018 Scalar_FLOAT64_IEEE 0 HANcoder_E407_TTA_Controller_v4_5_CM_double -1.7E+308 1.7E+308 /end CHARACTERISTIC
/begin CHARACTERISTIC torque_a_k_i "" VALUE 0x20000020 Scalar_FLOAT64_IEEE 0 HANcoder_E407_TTA_Controller_v4_5_CM_double -1.7E+308 1.7E+308 /end CHARACTERISTIC
/begin CHARACTERISTIC torque_a_k_p "" VALUE 0x20000048 Scalar_FLOAT64_IEEE 0 HANcoder_E407_TTA_Controller_v4_5_CM_double -1.7E+308 1.7E+308 /end CHARACTERISTIC
/begin CHARACTERISTIC torque_f_k_d "" VALUE 0x20000030 Scalar_FLOAT64_IEEE 0 HANcoder_E407_TTA_Controller_v4_5_CM_double -1.7E+308 1.7E+308 /end CHARACTERISTIC
/begin CHARACTERISTIC torque_f_k_i "" VALUE 0x20000028 Scalar_FLOAT64_IEEE 0 HANcoder_E407_TTA_Controller_v4_5_CM_double -1.7E+308 1.7E+308 /end CHARACTERISTIC
/begin CHARACTERISTIC torque_f_k_p "" VALUE 0x20000040 Scalar_FLOAT64_IEEE 0 HANcoder_E407_TTA_Controller_v4_5_CM_double -1.7E+308 1.7E+308 /end CHARACTERISTIC
/begin CHARACTERISTIC v_set "" VALUE 0x20000038 Scalar_FLOAT64_IEEE 0 HANcoder_E407_TTA_Controller_v4_5_CM_double -1.7E+308 1.7E+308 /end CHARACTERISTIC
/begin CHARACTERISTIC HANtuneOverride "" VALUE 0x20000010 Scalar_BOOLEAN 0 HANcoder_E407_TTA_Controller_v4_5_CM_boolean 0 1 /end CHARACTERISTIC
/begin MEASUREMENT simulation_time "" FLOAT64_IEEE HANcoder_E407_TTA_Controller_v4_5_CM_double 0 0 -1.7E+308 1.7E+308 ECU_ADDRESS 0x2000c3a0 /end MEASUREMENT
/begin MEASUREMENT script_run_s "" FLOAT64_IEEE HANcoder_E407_TTA_Controller_v4_5_CM_double 0 0 -1.7E+308 1.7E+308 ECU_ADDRESS 0x2000c2d0 /end MEASUREMENT
/begin MEASUREMENT Board_ID_s "" FLOAT64_IEEE HANcoder_E407_TTA_Controller_v4_5_CM_double 0 0 -1.7E+308 1.7E+308 ECU_ADDRESS 0x2000c1e8 /end MEASUREMENT
/begin MEASUREMENT SI_FreeHeap "" ULONG HANcoder_E407_TTA_Controller_v4_5_CM_uint32 0 0 0 4294967295 ECU_ADDRESS 0x2000c28c /end MEASUREMENT
/begin MEASUREMENT SI_FreeStack "" ULONG HANcoder_E407_TTA_Controller_v4_5_CM_uint32 0 0 0 4294967295 ECU_ADDRESS 0x2000c3d8 /end MEASUREMENT
/begin MEASUREMENT local_ticks_interrupt "" UWORD HANcoder_E407_TTA_Controller_v4_5_CM_uint16 0 0 0 65535 ECU_ADDRESS 0x2000c9c8 /end MEASUREMENT
/begin MEASUREMENT SI_CPUload "" UBYTE HANcoder_E407_TTA_Controller_v4_5_CM_uint8 0 0 0 255 ECU_ADDRESS 0x2000c960 /end MEASUREMENT
/begin MEASUREMENT LedValue "" UBYTE HANcoder_E407_TTA_Controller_v4_5_CM_boolean 0 0 0 1 ECU_ADDRESS 0x2000c2c0 /end MEASUREMENT
/begin MEASUREMENT Master_ID_vem_s "" FLOAT64_IEEE HANcoder_E407_TTA_Controller_v4_5_CM_double 0 0 -1.7E+308 1.7E+308 ECU_ADDRESS 0x2000c9a0 /end MEASUREMENT
/begin MEASUREMENT Role_ID_vem_s "" FLOAT64_IEEE HANcoder_E407_TTA_Controller_v4_5_CM_double 0 0 -1.7E+308 1.7E+308 ECU_ADDRESS 0x2000c1d8 /end MEASUREMENT
/begin MEASUREMENT sync_bc1_miss_counter_vem "" FLOAT64_IEEE HANcoder_E407_TTA_Controller_v4_5_CM_double 0 0 -1.7E+308 1.7E+308 ECU_ADDRESS 0x2000c280 /end MEASUREMENT
/begin MEASUREMENT sync_bc0_miss_counter_vem "" FLOAT64_IEEE HANcoder_E407_TTA_Controller_v4_5_CM_double 0 0 -1.7E+308 1.7E+308 ECU_ADDRESS 0x2000bb80 /end MEASUREMENT
/begin MEASUREMENT outcont_miss_counter_vem "" FLOAT64_IEEE HANcoder_E407_TTA_Controller_v4_5_CM_double 0 0 -1.7E+308 1.7E+308 ECU_ADDRESS 0x2000c908 /end MEASUREMENT
/begin MEASUREMENT msg_count_DEBUG_vem_s "" FLOAT64_IEEE HANcoder_E407_TTA_Controller_v4_5_CM_double 0 0 -1.7E+308 1.7E+308 ECU_ADDRESS 0x2000bbc8 /end MEASUREMENT
/begin MEASUREMENT Desync_Sync_bc1_vem_s "" FLOAT64_IEEE HANcoder_E407_TTA_Controller_v4_5_CM_double 0 0 -1.7E+308 1.7E+308 ECU_ADDRESS 0x2000c9d0 /end MEASUREMENT
/begin MEASUREMENT v_est_vem_s "" FLOAT64_IEEE HANcoder_E407_TTA_Controller_v4_5_CM_double 0 0 -1.7E+308 1.7E+308 ECU_ADDRESS 0x2000c3e0 /end MEASUREMENT
/begin MEASUREMENT theta_fr_s "" FLOAT64_IEEE HANcoder_E407_TTA_Controller_v4_5_CM_double 0 0 -1.7E+308 1.7E+308 ECU_ADDRESS 0x2000c910 /end MEASUREMENT
/begin MEASUREMENT theta_fl_s "" FLOAT64_IEEE HANcoder_E407_TTA_Controller_v4_5_CM_double 0 0 -1.7E+308 1.7E+308 ECU_ADDRESS 0x2000bb70 /end MEASUREMENT
/begin MEASUREMENT theta_ar_s "" FLOAT64_IEEE HANcoder_E407_TTA_Controller_v4_5_CM_double 0 0 -1.7E+308 1.7E+308 ECU_ADDRESS 0x2000c948 /end MEASUREMENT
/begin MEASUREMENT theta_al_s "" FLOAT64_IEEE HANcoder_E407_TTA_Controller_v4_5_CM_double 0 0 -1.7E+308 1.7E+308 ECU_ADDRESS 0x2000c320 /end MEASUREMENT
/begin MEASUREMENT Desync_Sync_bc0_vem_s "" FLOAT64_IEEE HANcoder_E407_TTA_Controller_v4_5_CM_double 0 0 -1.7E+308 1.7E+308 ECU_ADDRESS 0x2000bb50 /end MEASUREMENT
/begin MEASUREMENT Master_ID_ing_s "" FLOAT64_IEEE HANcoder_E407_TTA_Controller_v4_5_CM_double 0 0 -1.7E+308 1.7E+308 ECU_ADDRESS 0x2000c340 /end MEASUREMENT
/begin MEASUREMENT Role_ID_ing_s "" FLOAT64_IEEE HANcoder_E407_TTA_Controller_v4_5_CM_double 0 0 -1.7E+308 1.7E+308 ECU_ADDRESS 0x2000c250 /end MEASUREMENT
/begin MEASUREMENT sync_bc1_miss_counter_ing "" FLOAT64_IEEE HANcoder_E407_TTA_Controller_v4_5_CM_double 0 0 -1.7E+308 1.7E+308 ECU_ADDRESS 0x2000c210 /end MEASUREMENT
/begin MEASUREMENT sync_bc0_miss_counter_ing "" FLOAT64_IEEE HANcoder_E407_TTA_Controller_v4_5_CM_double 0 0 -1.7E+308 1.7E+308 ECU_ADDRESS 0x2000c290 /end MEASUREMENT
/begin MEASUREMENT msg_count_DEBUG_ing_s "" FLOAT64_IEEE HANcoder_E407_TTA_Controller_v4_5_CM_double 0 0 -1.7E+308 1.7E+308 ECU_ADDRESS 0x2000bc10 /end MEASUREMENT
/begin MEASUREMENT Desync_Sync_bc1_ing_s "" FLOAT64_IEEE HANcoder_E407_TTA_Controller_v4_5_CM_double 0 0 -1.7E+308 1.7E+308 ECU_ADDRESS 0x2000bb40 /end MEASUREMENT
/begin MEASUREMENT v_set_s "" FLOAT64_IEEE HANcoder_E407_TTA_Controller_v4_5_CM_double 0 0 -1.7E+308 1.7E+308 ECU_ADDRESS 0x2000bbd0 /end MEASUREMENT
/begin MEASUREMENT Desync_Sync_bc0_ing_s "" FLOAT64_IEEE HANcoder_E407_TTA_Controller_v4_5_CM_double 0 0 -1.7E+308 1.7E+308 ECU_ADDRESS 0x2000bb98 /end MEASUREMENT
/begin MEASUREMENT Master_ID_s "" FLOAT64_IEEE HANcoder_E407_TTA_Controller_v4_5_CM_double 0 0 -1.7E+308 1.7E+308 ECU_ADDRESS 0x2000c2b8 /end MEASUREMENT
/begin MEASUREMENT Role_ID_s "" FLOAT64_IEEE HANcoder_E407_TTA_Controller_v4_5_CM_double 0 0 -1.7E+308 1.7E+308 ECU_ADDRESS 0x2000bba8 /end MEASUREMENT
/begin MEASUREMENT sync_bc0_miss_counter_s "" FLOAT64_IEEE HANcoder_E407_TTA_Controller_v4_5_CM_double 0 0 -1.7E+308 1.7E+308 ECU_ADDRESS 0x2000c9d8 /end MEASUREMENT
/begin MEASUREMENT sync_bc1_miss_counter_s "" FLOAT64_IEEE HANcoder_E407_TTA_Controller_v4_5_CM_double 0 0 -1.7E+308 1.7E+308 ECU_ADDRESS 0x2000c2a0 /end MEASUREMENT
/begin MEASUREMENT set_miss_counter_s "" FLOAT64_IEEE HANcoder_E407_TTA_Controller_v4_5_CM_double 0 0 -1.7E+308 1.7E+308 ECU_ADDRESS 0x2000c2e8 /end MEASUREMENT
/begin MEASUREMENT sensor_miss_counter_s "" FLOAT64_IEEE HANcoder_E407_TTA_Controller_v4_5_CM_double 0 0 -1.7E+308 1.7E+308 ECU_ADDRESS 0x2000bb58 /end MEASUREMENT
/begin MEASUREMENT out1_miss_counter_s "" FLOAT64_IEEE HANcoder_E407_TTA_Controller_v4_5_CM_double 0 0 -1.7E+308 1.7E+308 ECU_ADDRESS 0x2000c258 /end MEASUREMENT
/begin MEASUREMENT out2_miss_counter_s "" FLOAT64_IEEE HANcoder_E407_TTA_Controller_v4_5_CM_double 0 0 -1.7E+308 1.7E+308 ECU_ADDRESS 0x2000bbb0 /end MEASUREMENT
/begin MEASUREMENT votes_Board_1_DEBUG "" FLOAT64_IEEE HANcoder_E407_TTA_Controller_v4_5_CM_double 0 0 -1.7E+308 1.7E+308 ECU_ADDRESS 0x2000c9a8 /end MEASUREMENT
/begin MEASUREMENT votes_Board_2_DEBUG "" FLOAT64_IEEE HANcoder_E407_TTA_Controller_v4_5_CM_double 0 0 -1.7E+308 1.7E+308 ECU_ADDRESS 0x2000c978 /end MEASUREMENT
/begin MEASUREMENT votes_Board_3_DEBUG "" FLOAT64_IEEE HANcoder_E407_TTA_Controller_v4_5_CM_double 0 0 -1.7E+308 1.7E+308 ECU_ADDRESS 0x2000c218 /end MEASUREMENT
/begin MEASUREMENT Board_1_error_counter_s "" FLOAT64_IEEE HANcoder_E407_TTA_Controller_v4_5_CM_double 0 0 -1.7E+308 1.7E+308 ECU_ADDRESS 0x2000c268 /end MEASUREMENT
/begin MEASUREMENT Board_2_error_counter_s "" FLOAT64_IEEE HANcoder_E407_TTA_Controller_v4_5_CM_double 0 0 -1.7E+308 1.7E+308 ECU_ADDRESS 0x2000bbe8 /end MEASUREMENT
/begin MEASUREMENT Board_3_error_counter_s "" FLOAT64_IEEE HANcoder_E407_TTA_Controller_v4_5_CM_double 0 0 -1.7E+308 1.7E+308 ECU_ADDRESS 0x2000c900 /end MEASUREMENT
/begin MEASUREMENT msg_count_DEBUG_s "" FLOAT64_IEEE HANcoder_E407_TTA_Controller_v4_5_CM_double 0 0 -1.7E+308 1.7E+308 ECU_ADDRESS 0x2000c240 /end MEASUREMENT
/begin MEASUREMENT torque_fr_set_out_s "" FLOAT64_IEEE HANcoder_E407_TTA_Controller_v4_5_CM_double 0 0 -1.7E+308 1.7E+308 ECU_ADDRESS 0x2000c3c0 /end MEASUREMENT
/begin MEASUREMENT torque_fl_set_out_s "" FLOAT64_IEEE HANcoder_E407_TTA_Controller_v4_5_CM_double 0 0 -1.7E+308 1.7E+308 ECU_ADDRESS 0x2000c968 /end MEASUREMENT
/begin MEASUREMENT torque_ar_set_out_s "" FLOAT64_IEEE HANcoder_E407_TTA_Controller_v4_5_CM_double 0 0 -1.7E+308 1.7E+308 ECU_ADDRESS 0x2000c2f0 /end MEASUREMENT
/begin MEASUREMENT torque_al_set_out_s "" FLOAT64_IEEE HANcoder_E407_TTA_Controller_v4_5_CM_double 0 0 -1.7E+308 1.7E+308 ECU_ADDRESS 0x2000c228 /end MEASUREMENT
/begin MEASUREMENT torque_fr_out2_s "" FLOAT64_IEEE HANcoder_E407_TTA_Controller_v4_5_CM_double 0 0 -1.7E+308 1.7E+308 ECU_ADDRESS 0x2000c9c0 /end MEASUREMENT
/begin MEASUREMENT torque_fl_out2_s "" FLOAT64_IEEE HANcoder_E407_TTA_Controller_v4_5_CM_double 0 0 -1.7E+308 1.7E+308 ECU_ADDRESS 0x2000bb88 /end MEASUREMENT
/begin MEASUREMENT torque_ar_out2_s "" FLOAT64_IEEE HANcoder_E407_TTA_Controller_v4_5_CM_double 0 0 -1.7E+308 1.7E+308 ECU_ADDRESS 0x2000bbe0 /end MEASUREMENT
/begin MEASUREMENT torque_al_out2_s "" FLOAT64_IEEE HANcoder_E407_TTA_Controller_v4_5_CM_double 0 0 -1.7E+308 1.7E+308 ECU_ADDRESS 0x2000c338 /end MEASUREMENT
/begin MEASUREMENT torque_fr_out1_s "" FLOAT64_IEEE HANcoder_E407_TTA_Controller_v4_5_CM_double 0 0 -1.7E+308 1.7E+308 ECU_ADDRESS 0x2000c278 /end MEASUREMENT
/begin MEASUREMENT torque_fl_out1_s "" FLOAT64_IEEE HANcoder_E407_TTA_Controller_v4_5_CM_double 0 0 -1.7E+308 1.7E+308 ECU_ADDRESS 0x2000c2d8 /end MEASUREMENT
/begin MEASUREMENT torque_ar_out1_s "" FLOAT64_IEEE HANcoder_E407_TTA_Controller_v4_5_CM_double 0 0 -1.7E+308 1.7E+308 ECU_ADDRESS 0x2000c248 /end MEASUREMENT
/begin MEASUREMENT torque_al_out1_s "" FLOAT64_IEEE HANcoder_E407_TTA_Controller_v4_5_CM_double 0 0 -1.7E+308 1.7E+308 ECU_ADDRESS 0x2000c398 /end MEASUREMENT
/begin MEASUREMENT Desync_Sync_bc1_s "" FLOAT64_IEEE HANcoder_E407_TTA_Controller_v4_5_CM_double 0 0 -1.7E+308 1.7E+308 ECU_ADDRESS 0x2000c358 /end MEASUREMENT
/begin MEASUREMENT mc_counter_s "" FLOAT64_IEEE HANcoder_E407_TTA_Controller_v4_5_CM_double 0 0 -1.7E+308 1.7E+308 ECU_ADDRESS 0x2000bb90 /end MEASUREMENT
/begin MEASUREMENT rx_data_incr_time_s "" FLOAT64_IEEE HANcoder_E407_TTA_Controller_v4_5_CM_double 0 0 -1.7E+308 1.7E+308 ECU_ADDRESS 0x2000c1f8 /end MEASUREMENT
/begin MEASUREMENT theta_fr_stored_s "" FLOAT64_IEEE HANcoder_E407_TTA_Controller_v4_5_CM_double 0 0 -1.7E+308 1.7E+308 ECU_ADDRESS 0x2000c930 /end MEASUREMENT
/begin MEASUREMENT theta_fl_stored_s "" FLOAT64_IEEE HANcoder_E407_TTA_Controller_v4_5_CM_double 0 0 -1.7E+308 1.7E+308 ECU_ADDRESS 0x2000c230 /end MEASUREMENT
/begin MEASUREMENT theta_ar_stored_s "" FLOAT64_IEEE HANcoder_E407_TTA_Controller_v4_5_CM_double 0 0 -1.7E+308 1.7E+308 ECU_ADDRESS 0x2000c920 /end MEASUREMENT
/begin MEASUREMENT theta_al_stored_s "" FLOAT64_IEEE HANcoder_E407_TTA_Controller_v4_5_CM_double 0 0 -1.7E+308 1.7E+308 ECU_ADDRESS 0x2000c300 /end MEASUREMENT
/begin MEASUREMENT v_est_s "" FLOAT64_IEEE HANcoder_E407_TTA_Controller_v4_5_CM_double 0 0 -1.7E+308 1.7E+308 ECU_ADDRESS 0x2000c378 /end MEASUREMENT
/begin MEASUREMENT v_integral_s "" FLOAT64_IEEE HANcoder_E407_TTA_Controller_v4_5_CM_double 0 0 -1.7E+308 1.7E+308 ECU_ADDRESS 0x2000bb60 /end MEASUREMENT
/begin MEASUREMENT v_ctreff_s "" FLOAT64_IEEE HANcoder_E407_TTA_Controller_v4_5_CM_double 0 0 -1.7E+308 1.7E+308 ECU_ADDRESS 0x2000c3d0 /end MEASUREMENT
/begin MEASUREMENT torque_fr_set_s "" FLOAT64_IEEE HANcoder_E407_TTA_Controller_v4_5_CM_double 0 0 -1.7E+308 1.7E+308 ECU_ADDRESS 0x2000c3a8 /end MEASUREMENT
/begin MEASUREMENT torque_fl_set_s "" FLOAT64_IEEE HANcoder_E407_TTA_Controller_v4_5_CM_double 0 0 -1.7E+308 1.7E+308 ECU_ADDRESS 0x2000c200 /end MEASUREMENT
/begin MEASUREMENT torque_ar_set_s "" FLOAT64_IEEE HANcoder_E407_TTA_Controller_v4_5_CM_double 0 0 -1.7E+308 1.7E+308 ECU_ADDRESS 0x2000c308 /end MEASUREMENT
/begin MEASUREMENT torque_al_set_s "" FLOAT64_IEEE HANcoder_E407_TTA_Controller_v4_5_CM_double 0 0 -1.7E+308 1.7E+308 ECU_ADDRESS 0x2000c940 /end MEASUREMENT
/begin MEASUREMENT Desync_Sync_bc0_s "" FLOAT64_IEEE HANcoder_E407_TTA_Controller_v4_5_CM_double 0 0 -1.7E+308 1.7E+308 ECU_ADDRESS 0x2000bbf0 /end MEASUREMENT
/begin MEASUREMENT TM1_timeout_counter_s "" FLOAT64_IEEE HANcoder_E407_TTA_Controller_v4_5_CM_double 0 0 -1.7E+308 1.7E+308 ECU_ADDRESS 0x2000c220 /end MEASUREMENT
/begin MEASUREMENT TM2_timeout_counter_s "" FLOAT64_IEEE HANcoder_E407_TTA_Controller_v4_5_CM_double 0 0 -1.7E+308 1.7E+308 ECU_ADDRESS 0x2000c3c8 /end MEASUREMENT
/begin MEASUREMENT TM3_timeout_counter_s "" FLOAT64_IEEE HANcoder_E407_TTA_Controller_v4_5_CM_double 0 0 -1.7E+308 1.7E+308 ECU_ADDRESS 0x2000c2a8 /end MEASUREMENT
/begin MEASUREMENT torque_fr_out3_bb "" FLOAT64_IEEE HANcoder_E407_TTA_Controller_v4_5_CM_double 0 0 -1.7E+308 1.7E+308 ECU_ADDRESS 0x2000c1d0 /end MEASUREMENT
/begin MEASUREMENT torque_fl_out3_bb "" FLOAT64_IEEE HANcoder_E407_TTA_Controller_v4_5_CM_double 0 0 -1.7E+308 1.7E+308 ECU_ADDRESS 0x2000c348 /end MEASUREMENT
/begin MEASUREMENT torque_ar_out3_bb "" FLOAT64_IEEE HANcoder_E407_TTA_Controller_v4_5_CM_double 0 0 -1.7E+308 1.7E+308 ECU_ADDRESS 0x2000c388 /end MEASUREMENT
/begin MEASUREMENT torque_al_out3_bb "" FLOAT64_IEEE HANcoder_E407_TTA_Controller_v4_5_CM_double 0 0 -1.7E+308 1.7E+308 ECU_ADDRESS 0x2000c368 /end MEASUREMENT
/begin MEASUREMENT torque_fr_out2_bb "" FLOAT64_IEEE HANcoder_E407_TTA_Controller_v4_5_CM_double 0 0 -1.7E+308 1.7E+308 ECU_ADDRESS 0x2000c3b8 /end MEASUREMENT
/begin MEASUREMENT torque_fl_out2_bb "" FLOAT64_IEEE HANcoder_E407_TTA_Controller_v4_5_CM_double 0 0 -1.7E+308 1.7E+308 ECU_ADDRESS 0x2000bbc0 /end MEASUREMENT
/begin MEASUREMENT torque_ar_out2_bb "" FLOAT64_IEEE HANcoder_E407_TTA_Controller_v4_5_CM_double 0 0 -1.7E+308 1.7E+308 ECU_ADDRESS 0x2000bc08 /end MEASUREMENT
/begin MEASUREMENT torque_al_out2_bb "" FLOAT64_IEEE HANcoder_E407_TTA_Controller_v4_5_CM_double 0 0 -1.7E+308 1.7E+308 ECU_ADDRESS 0x2000c318 /end MEASUREMENT
/begin MEASUREMENT torque_fr_out1_bb "" FLOAT64_IEEE HANcoder_E407_TTA_Controller_v4_5_CM_double 0 0 -1.7E+308 1.7E+308 ECU_ADDRESS 0x2000c2c8 /end MEASUREMENT
/begin MEASUREMENT torque_fl_out1_bb "" FLOAT64_IEEE HANcoder_E407_TTA_Controller_v4_5_CM_double 0 0 -1.7E+308 1.7E+308 ECU_ADDRESS 0x2000c988 /end MEASUREMENT
/begin MEASUREMENT torque_ar_out1_bb "" FLOAT64_IEEE HANcoder_E407_TTA_Controller_v4_5_CM_double 0 0 -1.7E+308 1.7E+308 ECU_ADDRESS 0x2000c970 /end MEASUREMENT
/begin MEASUREMENT torque_al_out1_bb "" FLOAT64_IEEE HANcoder_E407_TTA_Controller_v4_5_CM_double 0 0 -1.7E+308 1.7E+308 ECU_ADDRESS 0x2000c958 /end MEASUREMENT
/begin MEASUREMENT Rx_init_LT "" UWORD HANcoder_E407_TTA_Controller_v4_5_CM_uint16 0 0 0 65535 ECU_ADDRESS 0x2000c366 /end MEASUREMENT
/begin MEASUREMENT TMR_miss1_set "" UBYTE HANcoder_E407_TTA_Controller_v4_5_CM_uint8 0 0 0 255 ECU_ADDRESS 0x2000c980 /end MEASUREMENT
/begin MEASUREMENT TMR_miss2_set "" UBYTE HANcoder_E407_TTA_Controller_v4_5_CM_uint8 0 0 0 255 ECU_ADDRESS 0x2000c208 /end MEASUREMENT
/begin MEASUREMENT TMR_miss1_sensor "" UBYTE HANcoder_E407_TTA_Controller_v4_5_CM_uint8 0 0 0 255 ECU_ADDRESS 0x2000c331 /end MEASUREMENT
/begin MEASUREMENT TMR_miss2_sensor "" UBYTE HANcoder_E407_TTA_Controller_v4_5_CM_uint8 0 0 0 255 ECU_ADDRESS 0x2000c390 /end MEASUREMENT
/begin MEASUREMENT error_log1_s "" UBYTE HANcoder_E407_TTA_Controller_v4_5_CM_uint8 0 0 0 255 ECU_ADDRESS 0x2000c918 /end MEASUREMENT
/begin MEASUREMENT tau_fr1_disagree_s "" UBYTE HANcoder_E407_TTA_Controller_v4_5_CM_uint8 0 0 0 255 ECU_ADDRESS 0x2000c3e8 /end MEASUREMENT
/begin MEASUREMENT tau_fl1_disagree_s "" UBYTE HANcoder_E407_TTA_Controller_v4_5_CM_uint8 0 0 0 255 ECU_ADDRESS 0x2000bb4b /end MEASUREMENT
/begin MEASUREMENT tau_ar1_disagree_s "" UBYTE HANcoder_E407_TTA_Controller_v4_5_CM_uint8 0 0 0 255 ECU_ADDRESS 0x2000c372 /end MEASUREMENT
/begin MEASUREMENT tau_al1_disagree_s "" UBYTE HANcoder_E407_TTA_Controller_v4_5_CM_uint8 0 0 0 255 ECU_ADDRESS 0x2000bba0 /end MEASUREMENT
/begin MEASUREMENT tau_fr2_disagree_s "" UBYTE HANcoder_E407_TTA_Controller_v4_5_CM_uint8 0 0 0 255 ECU_ADDRESS 0x2000bba1 /end MEASUREMENT
/begin MEASUREMENT tau_fl2_disagree_s "" UBYTE HANcoder_E407_TTA_Controller_v4_5_CM_uint8 0 0 0 255 ECU_ADDRESS 0x2000bb49 /end MEASUREMENT
/begin MEASUREMENT tau_ar2_disagree_s "" UBYTE HANcoder_E407_TTA_Controller_v4_5_CM_uint8 0 0 0 255 ECU_ADDRESS 0x2000bbd8 /end MEASUREMENT
/begin MEASUREMENT tau_al2_disagree_s "" UBYTE HANcoder_E407_TTA_Controller_v4_5_CM_uint8 0 0 0 255 ECU_ADDRESS 0x2000bbb8 /end MEASUREMENT
/begin MEASUREMENT error_log2_s "" UBYTE HANcoder_E407_TTA_Controller_v4_5_CM_uint8 0 0 0 255 ECU_ADDRESS 0x2000c380 /end MEASUREMENT
/begin MEASUREMENT tau_fr_disagree_s "" UBYTE HANcoder_E407_TTA_Controller_v4_5_CM_uint8 0 0 0 255 ECU_ADDRESS 0x2000c990 /end MEASUREMENT
/begin MEASUREMENT tau_fl_disagree_s "" UBYTE HANcoder_E407_TTA_Controller_v4_5_CM_uint8 0 0 0 255 ECU_ADDRESS 0x2000bbb9 /end MEASUREMENT
/begin MEASUREMENT tau_ar_disagree_s "" UBYTE HANcoder_E407_TTA_Controller_v4_5_CM_uint8 0 0 0 255 ECU_ADDRESS 0x2000c262 /end MEASUREMENT
/begin MEASUREMENT tau_al_disagree_s "" UBYTE HANcoder_E407_TTA_Controller_v4_5_CM_uint8 0 0 0 255 ECU_ADDRESS 0x2000c260 /end MEASUREMENT
/begin MEASUREMENT error_log3_s "" UBYTE HANcoder_E407_TTA_Controller_v4_5_CM_uint8 0 0 0 255 ECU_ADDRESS 0x2000c3dd /end MEASUREMENT
/begin MEASUREMENT Vote_s "" UBYTE HANcoder_E407_TTA_Controller_v4_5_CM_uint8 0 0 0 255 ECU_ADDRESS 0x2000bb48 /end MEASUREMENT
/begin MEASUREMENT Rx_init_id "" UBYTE HANcoder_E407_TTA_Controller_v4_5_CM_uint8 0 0 0 255 ECU_ADDRESS 0x2000c928 /end MEASUREMENT
/begin MEASUREMENT Rx_init_mc "" UBYTE HANcoder_E407_TTA_Controller_v4_5_CM_uint8 0 0 0 255 ECU_ADDRESS 0x2000c950 /end MEASUREMENT
/begin MEASUREMENT Rx_init_bc "" UBYTE HANcoder_E407_TTA_Controller_v4_5_CM_uint8 0 0 0 255 ECU_ADDRESS 0x2000c270 /end MEASUREMENT
/begin MEASUREMENT bacic_cycle_s "" UBYTE HANcoder_E407_TTA_Controller_v4_5_CM_uint8 0 0 0 255 ECU_ADDRESS 0x2000c263 /end MEASUREMENT
/begin MEASUREMENT BC1_sync_processed_vem__s "" UBYTE HANcoder_E407_TTA_Controller_v4_5_CM_boolean 0 0 0 1 ECU_ADDRESS 0x2000bb79 /end MEASUREMENT
/begin MEASUREMENT BC0_sync_processed_vem__s "" UBYTE HANcoder_E407_TTA_Controller_v4_5_CM_boolean 0 0 0 1 ECU_ADDRESS 0x2000c1e5 /end MEASUREMENT
/begin MEASUREMENT new_sensor_rx_vem_s "" UBYTE HANcoder_E407_TTA_Controller_v4_5_CM_boolean 0 0 0 1 ECU_ADDRESS 0x2000bb68 /end MEASUREMENT
/begin MEASUREMENT reset_vem_s "" UBYTE HANcoder_E407_TTA_Controller_v4_5_CM_boolean 0 0 0 1 ECU_ADDRESS 0x2000c1f0 /end MEASUREMENT
/begin MEASUREMENT BC1_sync_processed_ing_s "" UBYTE HANcoder_E407_TTA_Controller_v4_5_CM_boolean 0 0 0 1 ECU_ADDRESS 0x2000c3b0 /end MEASUREMENT
/begin MEASUREMENT BC0_sync_processed_ing_s "" UBYTE HANcoder_E407_TTA_Controller_v4_5_CM_boolean 0 0 0 1 ECU_ADDRESS 0x2000c929 /end MEASUREMENT
/begin MEASUREMENT reset_ing_s "" UBYTE HANcoder_E407_TTA_Controller_v4_5_CM_boolean 0 0 0 1 ECU_ADDRESS 0x2000c2b2 /end MEASUREMENT
/begin MEASUREMENT BC1_sync_processed_s "" UBYTE HANcoder_E407_TTA_Controller_v4_5_CM_boolean 0 0 0 1 ECU_ADDRESS 0x2000c938 /end MEASUREMENT
/begin MEASUREMENT BC0_sync_processed_s "" UBYTE HANcoder_E407_TTA_Controller_v4_5_CM_boolean 0 0 0 1 ECU_ADDRESS 0x2000bb4a /end MEASUREMENT
/begin MEASUREMENT BC0_vote1_processed_s "" UBYTE HANcoder_E407_TTA_Controller_v4_5_CM_boolean 0 0 0 1 ECU_ADDRESS 0x2000c310 /end MEASUREMENT
/begin MEASUREMENT BC0_vote2_processed_s "" UBYTE HANcoder_E407_TTA_Controller_v4_5_CM_boolean 0 0 0 1 ECU_ADDRESS 0x2000c3dc /end MEASUREMENT
/begin MEASUREMENT BC0_vote3_processed_s "" UBYTE HANcoder_E407_TTA_Controller_v4_5_CM_boolean 0 0 0 1 ECU_ADDRESS 0x2000c330 /end MEASUREMENT
/begin MEASUREMENT TMR_miss_set "" UBYTE HANcoder_E407_TTA_Controller_v4_5_CM_boolean 0 0 0 1 ECU_ADDRESS 0x2000c1e4 /end MEASUREMENT
/begin MEASUREMENT TMR_miss_sensor "" UBYTE HANcoder_E407_TTA_Controller_v4_5_CM_boolean 0 0 0 1 ECU_ADDRESS 0x2000c288 /end MEASUREMENT
/begin MEASUREMENT TMR_miss_out1 "" UBYTE HANcoder_E407_TTA_Controller_v4_5_CM_boolean 0 0 0 1 ECU_ADDRESS 0x2000c2f8 /end MEASUREMENT
/begin MEASUREMENT TMR_miss_out2 "" UBYTE HANcoder_E407_TTA_Controller_v4_5_CM_boolean 0 0 0 1 ECU_ADDRESS 0x2000c370 /end MEASUREMENT
/begin MEASUREMENT new_set_rx_s "" UBYTE HANcoder_E407_TTA_Controller_v4_5_CM_boolean 0 0 0 1 ECU_ADDRESS 0x2000bb78 /end MEASUREMENT
/begin MEASUREMENT new_sensor_rx_s "" UBYTE HANcoder_E407_TTA_Controller_v4_5_CM_boolean 0 0 0 1 ECU_ADDRESS 0x2000c271 /end MEASUREMENT
/begin MEASUREMENT out2_rx_s "" UBYTE HANcoder_E407_TTA_Controller_v4_5_CM_boolean 0 0 0 1 ECU_ADDRESS 0x2000c1f1 /end MEASUREMENT
/begin MEASUREMENT out1_rx_s "" UBYTE HANcoder_E407_TTA_Controller_v4_5_CM_boolean 0 0 0 1 ECU_ADDRESS 0x2000c9b8 /end MEASUREMENT
/begin MEASUREMENT reset_s "" UBYTE HANcoder_E407_TTA_Controller_v4_5_CM_boolean 0 0 0 1 ECU_ADDRESS 0x2000c364 /end MEASUREMENT
/begin MEASUREMENT tau_fr_out12_agree "" UBYTE HANcoder_E407_TTA_Controller_v4_5_CM_boolean 0 0 0 1 ECU_ADDRESS 0x2000c371 /end MEASUREMENT
/begin MEASUREMENT tau_fr_out23_agree "" UBYTE HANcoder_E407_TTA_Controller_v4_5_CM_boolean 0 0 0 1 ECU_ADDRESS 0x2000c261 /end MEASUREMENT
/begin MEASUREMENT tau_fr_out13_agree "" UBYTE HANcoder_E407_TTA_Controller_v4_5_CM_boolean 0 0 0 1 ECU_ADDRESS 0x2000c209 /end MEASUREMENT
/begin MEASUREMENT Tx_temporal_msg_CAN2 "" FLOAT64_IEEE HANcoder_E407_TTA_Controller_v4_5_CM_double 0 0 -1.7E+308 1.7E+308 ECU_ADDRESS 0x2000c238 /end MEASUREMENT
/begin MEASUREMENT TxCAN2_counter_s "" ULONG HANcoder_E407_TTA_Controller_v4_5_CM_uint32 0 0 0 4294967295 ECU_ADDRESS 0x2000c360 /end MEASUREMENT
/begin MEASUREMENT TxID_CAN2_s "" ULONG HANcoder_E407_TTA_Controller_v4_5_CM_uint32 0 0 0 4294967295 ECU_ADDRESS 0x2000bc04 /end MEASUREMENT
/begin MEASUREMENT Rx_temporal_msg_CAN2 "" FLOAT64_IEEE HANcoder_E407_TTA_Controller_v4_5_CM_double 0 0 -1.7E+308 1.7E+308 ECU_ADDRESS 0x2000c998 /end MEASUREMENT
/begin MEASUREMENT RxCAN2_counter_s "" ULONG HANcoder_E407_TTA_Controller_v4_5_CM_uint32 0 0 0 4294967295 ECU_ADDRESS 0x2000c350 /end MEASUREMENT
/begin MEASUREMENT RxID_CAN2_s "" ULONG HANcoder_E407_TTA_Controller_v4_5_CM_uint32 0 0 0 4294967295 ECU_ADDRESS 0x2000c994 /end MEASUREMENT
/begin MEASUREMENT Rx_msg_ticks_CAN2 "" UWORD HANcoder_E407_TTA_Controller_v4_5_CM_uint16 0 0 0 65535 ECU_ADDRESS 0x2000c9ba /end MEASUREMENT
/begin MEASUREMENT Rx_temporal_msg_CAN1 "" FLOAT64_IEEE HANcoder_E407_TTA_Controller_v4_5_CM_double 0 0 -1.7E+308 1.7E+308 ECU_ADDRESS 0x2000c328 /end MEASUREMENT
/begin MEASUREMENT RxCAN1_counter_s "" ULONG HANcoder_E407_TTA_Controller_v4_5_CM_uint32 0 0 0 4294967295 ECU_ADDRESS 0x2000c1e0 /end MEASUREMENT
/begin MEASUREMENT RxID_CAN1_s "" ULONG HANcoder_E407_TTA_Controller_v4_5_CM_uint32 0 0 0 4294967295 ECU_ADDRESS 0x2000c2b4 /end MEASUREMENT
/begin MEASUREMENT Rx_msg_ticks_CAN1 "" UWORD HANcoder_E407_TTA_Controller_v4_5_CM_uint16 0 0 0 65535 ECU_ADDRESS 0x2000c2b0 /end MEASUREMENT
/begin MEASUREMENT Tx_temporal_msg_CAN1 "" FLOAT64_IEEE HANcoder_E407_TTA_Controller_v4_5_CM_double 0 0 -1.7E+308 1.7E+308 ECU_ADDRESS 0x2000c9b0 /end MEASUREMENT
/begin MEASUREMENT TxCAN1_counter_s "" ULONG HANcoder_E407_TTA_Controller_v4_5_CM_uint32 0 0 0 4294967295 ECU_ADDRESS 0x2000c92c /end MEASUREMENT
/begin MEASUREMENT TxID_CAN1_s "" ULONG HANcoder_E407_TTA_Controller_v4_5_CM_uint32 0 0 0 4294967295 ECU_ADDRESS 0x2000c298 /end MEASUREMENT
/begin COMPU_METHOD HANcoder_E407_TTA_Controller_v4_5_CM_double "Q = V" RAT_FUNC "%15.10" "" COEFFS 0 1 0 0 0 1 /end COMPU_METHOD
/begin COMPU_METHOD HANcoder_E407_TTA_Controller_v4_5_CM_boolean "Q = V" RAT_FUNC "%1.0" "" COEFFS 0 1 0 0 0 1 /end COMPU_METHOD
/begin COMPU_METHOD HANcoder_E407_TTA_Controller_v4_5_CM_uint32 "Q = V" RAT_FUNC "%10.0" "" COEFFS 0 1 0 0 0 1 /end COMPU_METHOD
/begin COMPU_METHOD HANcoder_E407_TTA_Controller_v4_5_CM_uint16 "Q = V" RAT_FUNC "%5.0" "" COEFFS 0 1 0 0 0 1 /end COMPU_METHOD
/begin COMPU_METHOD HANcoder_E407_TTA_Controller_v4_5_CM_uint8 "Q = V" RAT_FUNC "%3.0" "" COEFFS 0 1 0 0 0 1 /end COMPU_METHOD
/begin GROUP HANcoder_E407_TTA_Controller_v4_5 "HANcoder_E407_TTA_Controller_v4_5" /* Root */ ROOT /begin SUB_GROUP Root_HANcoder_STM32_Target___E407_STM32_algorithm /end SUB_GROUP /end GROUP
/begin GROUP Root_HANcoder_STM32_Target___E407_STM32_algorithm "HANcoder_E407_TTA_Controller_v4_5/HANcoder STM32 Target - E407-STM32 algorithm" /begin SUB_GROUP S1_Algorithm S1_System_information S1_TTA_CAN_System /end SUB_GROUP /end GROUP
/begin GROUP S1_Algorithm "HANcoder_E407_TTA_Controller_v4_5/HANcoder STM32 Target - E407-STM32 algorithm/Algorithm" /begin REF_CHARACTERISTIC HANtuneOverride /end REF_CHARACTERISTIC /begin REF_MEASUREMENT LedValue /end REF_MEASUREMENT /end GROUP
/begin GROUP S1_System_information "HANcoder_E407_TTA_Controller_v4_5/HANcoder STM32 Target - E407-STM32 algorithm/System information" /begin SUB_GROUP S9_Get_CPU_load S9_Get_free_Heap S9_Get_free_Stack /end SUB_GROUP /end GROUP
/begin GROUP S1_TTA_CAN_System "HANcoder_E407_TTA_Controller_v4_5/HANcoder STM32 Target - E407-STM32 algorithm/TTA CAN System"
 /begin SUB_GROUP S10_CAN1_Recieve S10_CAN1_Send S10_CAN2_Recieve S10_CAN2_Send S10_If_Action_Subsystem S10_Local_Time_generation S10_TTA_System /end SUB_GROUP
 /begin REF_CHARACTERISTIC script_run /end REF_CHARACTERISTIC
 /begin REF_MEASUREMENT script_run_s simulation_time /end REF_MEASUREMENT
/end GROUP
/begin GROUP S9_Get_CPU_load "HANcoder_E407_TTA_Controller_v4_5/HANcoder STM32 Target - E407-STM32 algorithm/System information/Get CPU load" /begin REF_MEASUREMENT SI_CPUload /end REF_MEASUREMENT /end GROUP
/begin GROUP S9_Get_free_Heap "HANcoder_E407_TTA_Controller_v4_5/HANcoder STM32 Target - E407-STM32 algorithm/System information/Get free Heap" /begin REF_MEASUREMENT SI_FreeHeap /end REF_MEASUREMENT /end GROUP
/begin GROUP S9_Get_free_Stack "HANcoder_E407_TTA_Controller_v4_5/HANcoder STM32 Target - E407-STM32 algorithm/System information/Get free Stack" /begin REF_MEASUREMENT SI_FreeStack /end REF_MEASUREMENT /end GROUP
/begin GROUP S10_CAN1_Recieve "HANcoder_E407_TTA_Controller_v4_5/HANcoder STM32 Target - E407-STM32 algorithm/TTA CAN System/CAN1 Recieve" /begin SUB_GROUP S26_Update_message_buffers /end SUB_GROUP /begin REF_MEASUREMENT RxCAN1_counter_s RxID_CAN1_s /end REF_MEASUREMENT /end GROUP
/begin GROUP S10_CAN1_Send "HANcoder_E407_TTA_Controller_v4_5/HANcoder STM32 Target - E407-STM32 algorithm/TTA CAN System/CAN1 Send" /begin REF_MEASUREMENT TxCAN1_counter_s TxID_CAN1_s Tx_temporal_msg_CAN1 /end REF_MEASUREMENT /end GROUP
/begin GROUP S10_CAN2_Recieve "HANcoder_E407_TTA_Controller_v4_5/HANcoder STM32 Target - E407-STM32 algorithm/TTA CAN System/CAN2 Recieve" /begin SUB_GROUP S28_Update_message_buffers /end SUB_GROUP /begin REF_MEASUREMENT RxCAN2_counter_s RxID_CAN2_s /end REF_MEASUREMENT /end GROUP
/begin GROUP S10_CAN2_Send "HANcoder_E407_TTA_Controller_v4_5/HANcoder STM32 Target - E407-STM32 algorithm/TTA CAN System/CAN2 Send" /begin REF_MEASUREMENT TxCAN2_counter_s TxID_CAN2_s Tx_temporal_msg_CAN2 /end REF_MEASUREMENT /end GROUP
/begin GROUP S10_If_Action_Subsystem "HANcoder_E407_TTA_Controller_v4_5/HANcoder STM32 Target - E407-STM32 algorithm/TTA CAN System/If Action Subsystem" /begin REF_MEASUREMENT Board_ID_s /end REF_MEASUREMENT /end GROUP
/begin GROUP S10_Local_Time_generation "HANcoder_E407_TTA_Controller_v4_5/HANcoder STM32 Target - E407-STM32 algorithm/TTA CAN System/Local Time generation" /begin REF_MEASUREMENT local_ticks_interrupt /end REF_MEASUREMENT /end GROUP
/begin GROUP S10_TTA_System "HANcoder_E407_TTA_Controller_v4_5/HANcoder STM32 Target - E407-STM32 algorithm/TTA CAN System/TTA System"
 /begin SUB_GROUP S37_Basic_Cycle_Increment S37_Initialization S37_LT_Update_Desync_Positive S37_Matrix_Cycle_Manager /end SUB_GROUP
/end GROUP
/begin GROUP S26_Update_message_buffers "HANcoder_E407_TTA_Controller_v4_5/HANcoder STM32 Target - E407-STM32 algorithm/TTA CAN System/CAN1 Recieve/Update message buffers" /begin REF_MEASUREMENT Rx_msg_ticks_CAN1 Rx_temporal_msg_CAN1 /end REF_MEASUREMENT /end GROUP
/begin GROUP S28_Update_message_buffers "HANcoder_E407_TTA_Controller_v4_5/HANcoder STM32 Target - E407-STM32 algorithm/TTA CAN System/CAN2 Recieve/Update message buffers" /begin REF_MEASUREMENT Rx_msg_ticks_CAN2 Rx_temporal_msg_CAN2 /end REF_MEASUREMENT /end GROUP
/begin GROUP S37_Basic_Cycle_Increment "HANcoder_E407_TTA_Controller_v4_5/HANcoder STM32 Target - E407-STM32 algorithm/TTA CAN System/TTA System/Basic Cycle Increment" /begin REF_MEASUREMENT bacic_cycle_s /end REF_MEASUREMENT /end GROUP
/begin GROUP S37_Initialization "HANcoder_E407_TTA_Controller_v4_5/HANcoder STM32 Target - E407-STM32 algorithm/TTA CAN System/TTA System/Initialization" /begin SUB_GROUP S129_RoleID_and_Global_Time_init /end SUB_GROUP /end GROUP
/begin GROUP S37_LT_Update_Desync_Positive "HANcoder_E407_TTA_Controller_v4_5/HANcoder STM32 Target - E407-STM32 algorithm/TTA CAN System/TTA System/LT_Update Desync_Positive" /begin REF_CHARACTERISTIC COMM_Phase1 COMM_Phase2 COMM_Phase_init1 COMM_Phase_init2 /end REF_CHARACTERISTIC /end GROUP
/begin GROUP S37_Matrix_Cycle_Manager "HANcoder_E407_TTA_Controller_v4_5/HANcoder STM32 Target - E407-STM32 algorithm/TTA CAN System/TTA System/Matrix Cycle Manager"
 /begin SUB_GROUP S135_Backup_Board_Matrix_Cycle S135_Controller_Matrix_Cycle S135_Input_Generator_Matrix_Cycle S135_Vehicle_Emulator_Matrix_Cycle /end SUB_GROUP
/end GROUP
/begin GROUP S129_RoleID_and_Global_Time_init "HANcoder_E407_TTA_Controller_v4_5/HANcoder STM32 Target - E407-STM32 algorithm/TTA CAN System/TTA System/Initialization/RoleID and Global Time init" /begin SUB_GROUP S142_Global_Time_Initialization_Slave /end SUB_GROUP /end GROUP
/begin GROUP S135_Backup_Board_Matrix_Cycle "HANcoder_E407_TTA_Controller_v4_5/HANcoder STM32 Target - E407-STM32 algorithm/TTA CAN System/TTA System/Matrix Cycle Manager/Backup Board Matrix Cycle"
 /begin SUB_GROUP S187_Backup_board_basic_cycle_0 S187_Backup_board_basic_cycle_1 /end SUB_GROUP
/end GROUP
/begin GROUP S135_Controller_Matrix_Cycle "HANcoder_E407_TTA_Controller_v4_5/HANcoder STM32 Target - E407-STM32 algorithm/TTA CAN System/TTA System/Matrix Cycle Manager/Controller Matrix Cycle"
 /begin SUB_GROUP S188_Matrix_Cycle_Observation_DEBUG S188_controller_basic_cycle_0 S188_controller_basic_cycle_1 S188_msg_count_DEBUG_observer /end SUB_GROUP
/end GROUP
/begin GROUP S135_Input_Generator_Matrix_Cycle "HANcoder_E407_TTA_Controller_v4_5/HANcoder STM32 Target - E407-STM32 algorithm/TTA CAN System/TTA System/Matrix Cycle Manager/Input Generator Matrix Cycle"
 /begin SUB_GROUP S189_Matrix_Cycle_Observation_DEBUG S189_input_generator_basic_cycle_0 S189_input_generator_basic_cycle_1 S189_msg_count_DEBUG_observer /end SUB_GROUP
/end GROUP
/begin GROUP S135_Vehicle_Emulator_Matrix_Cycle "HANcoder_E407_TTA_Controller_v4_5/HANcoder STM32 Target - E407-STM32 algorithm/TTA CAN System/TTA System/Matrix Cycle Manager/Vehicle Emulator Matrix Cycle"
 /begin SUB_GROUP S190_Matrix_Cycle_Observation_DEBUG S190_msg_count_DEBUG_observer S190_vehicle_emulator_basic_cycle_0 S190_vehicle_emulator_basic_cycle_1 /end SUB_GROUP
/end GROUP
/begin GROUP S142_Global_Time_Initialization_Slave "HANcoder_E407_TTA_Controller_v4_5/HANcoder STM32 Target - E407-STM32 algorithm/TTA CAN System/TTA System/Initialization/RoleID and Global Time init/Global Time Initialization Slave" /begin SUB_GROUP S144_msg_decoding /end SUB_GROUP /begin REF_CHARACTERISTIC COMM_Phase1 COMM_Phase2 /end REF_CHARACTERISTIC /begin REF_MEASUREMENT Rx_init_LT /end REF_MEASUREMENT /end GROUP
/begin GROUP S187_Backup_board_basic_cycle_0 "HANcoder_E407_TTA_Controller_v4_5/HANcoder STM32 Target - E407-STM32 algorithm/TTA CAN System/TTA System/Matrix Cycle Manager/Backup Board Matrix Cycle/Backup board basic cycle 0" /begin SUB_GROUP S191_COMM_Task___Sync_bc_0 S191_COMP_Task___Sync_bc0_check /end SUB_GROUP /end GROUP
/begin GROUP S187_Backup_board_basic_cycle_1 "HANcoder_E407_TTA_Controller_v4_5/HANcoder STM32 Target - E407-STM32 algorithm/TTA CAN System/TTA System/Matrix Cycle Manager/Backup Board Matrix Cycle/Backup board basic cycle 1"
 /begin SUB_GROUP S192_COMM_Task___Sync_bc_1 S192_COMP_Task___MF S192_COMP_Task___Sync_bc1_check /end SUB_GROUP
/end GROUP
/begin GROUP S188_Matrix_Cycle_Observation_DEBUG "HANcoder_E407_TTA_Controller_v4_5/HANcoder STM32 Target - E407-STM32 algorithm/TTA CAN System/TTA System/Matrix Cycle Manager/Controller Matrix Cycle/Matrix_Cycle_Observation_DEBUG"
 /begin REF_MEASUREMENT BC0_sync_processed_s BC0_vote1_processed_s BC0_vote2_processed_s BC0_vote3_processed_s BC1_sync_processed_s Board_1_error_counter_s Board_2_error_counter_s Board_3_error_counter_s Master_ID_s Role_ID_s out1_miss_counter_s out2_miss_counter_s sensor_miss_counter_s set_miss_counter_s sync_bc0_miss_counter_s sync_bc1_miss_counter_s votes_Board_1_DEBUG votes_Board_2_DEBUG votes_Board_3_DEBUG /end REF_MEASUREMENT
/end GROUP
/begin GROUP S188_controller_basic_cycle_0 "HANcoder_E407_TTA_Controller_v4_5/HANcoder STM32 Target - E407-STM32 algorithm/TTA CAN System/TTA System/Matrix Cycle Manager/Controller Matrix Cycle/controller basic cycle 0"
 /begin SUB_GROUP S545_COMM_Task___Sync_bc_0 S545_COMM_Task___Vote1 S545_COMM_Task___Vote2 S545_COMM_Task___Vote3 S545_COMP_Task___Check_Timeouts S545_COMP_Task___Reset_Board S545_COMP_Task___Sync_bc0_check S545_COMP_Task___Vote_Decision /end SUB_GROUP
/end GROUP
/begin GROUP S188_controller_basic_cycle_1 "HANcoder_E407_TTA_Controller_v4_5/HANcoder STM32 Target - E407-STM32 algorithm/TTA CAN System/TTA System/Matrix Cycle Manager/Controller Matrix Cycle/controller basic cycle 1"
 /begin SUB_GROUP S546_COMM_Task___Output_Control1 S546_COMM_Task___Output_Control2 S546_COMM_Task___Output_Control3 S546_COMM_Task___Output_Emulator S546_COMM_Task___Sensor_Values S546_COMM_Task___Set_Values S546_COMM_Task___Sync_bc_1 S546_COMP_Task___Calculate_Speed S546_COMP_Task___Calculate_Steer S546_COMP_Task___Calculate_Torque S546_COMP_Task___Rx_Output_Control1_Check S546_COMP_Task___Rx_Output_Control2_Check S546_COMP_Task___Rx_Sensor_Values_Check S546_COMP_Task___Rx_Set_Values_Check S546_COMP_Task___Sync_bc1_check S546_COMP_Task___TMR /end SUB_GROUP
/end GROUP
/begin GROUP S188_msg_count_DEBUG_observer "HANcoder_E407_TTA_Controller_v4_5/HANcoder STM32 Target - E407-STM32 algorithm/TTA CAN System/TTA System/Matrix Cycle Manager/Controller Matrix Cycle/msg_count_DEBUG observer" /begin REF_MEASUREMENT msg_count_DEBUG_s /end REF_MEASUREMENT /end GROUP
/begin GROUP S189_Matrix_Cycle_Observation_DEBUG "HANcoder_E407_TTA_Controller_v4_5/HANcoder STM32 Target - E407-STM32 algorithm/TTA CAN System/TTA System/Matrix Cycle Manager/Input Generator Matrix Cycle/Matrix_Cycle_Observation_DEBUG"
 /begin REF_MEASUREMENT BC0_sync_processed_ing_s BC1_sync_processed_ing_s Master_ID_ing_s Role_ID_ing_s sync_bc0_miss_counter_ing sync_bc1_miss_counter_ing /end REF_MEASUREMENT
/end GROUP
/begin GROUP S189_input_generator_basic_cycle_0 "HANcoder_E407_TTA_Controller_v4_5/HANcoder STM32 Target - E407-STM32 algorithm/TTA CAN System/TTA System/Matrix Cycle Manager/Input Generator Matrix Cycle/input generator basic cycle 0"
 /begin SUB_GROUP S1339_COMM_Task___Sync_bc_0 S1339_COMP_Task___Reset_Board S1339_COMP_Task___Sync_bc0_check /end SUB_GROUP
/end GROUP
/begin GROUP S189_input_generator_basic_cycle_1 "HANcoder_E407_TTA_Controller_v4_5/HANcoder STM32 Target - E407-STM32 algorithm/TTA CAN System/TTA System/Matrix Cycle Manager/Input Generator Matrix Cycle/input generator basic cycle 1"
 /begin SUB_GROUP S1340_COMM_Task___Set_Values S1340_COMM_Task___Sync_bc_1 S1340_COMP_Task___Sync_bc1_check /end SUB_GROUP
/end GROUP
/begin GROUP S189_msg_count_DEBUG_observer "HANcoder_E407_TTA_Controller_v4_5/HANcoder STM32 Target - E407-STM32 algorithm/TTA CAN System/TTA System/Matrix Cycle Manager/Input Generator Matrix Cycle/msg_count_DEBUG observer" /begin REF_MEASUREMENT msg_count_DEBUG_ing_s /end REF_MEASUREMENT /end GROUP
/begin GROUP S190_Matrix_Cycle_Observation_DEBUG "HANcoder_E407_TTA_Controller_v4_5/HANcoder STM32 Target - E407-STM32 algorithm/TTA CAN System/TTA System/Matrix Cycle Manager/Vehicle Emulator Matrix Cycle/Matrix_Cycle_Observation_DEBUG"
 /begin REF_MEASUREMENT BC0_sync_processed_vem__s BC1_sync_processed_vem__s Master_ID_vem_s Role_ID_vem_s outcont_miss_counter_vem sync_bc0_miss_counter_vem sync_bc1_miss_counter_vem /end REF_MEASUREMENT
/end GROUP
/begin GROUP S190_msg_count_DEBUG_observer "HANcoder_E407_TTA_Controller_v4_5/HANcoder STM32 Target - E407-STM32 algorithm/TTA CAN System/TTA System/Matrix Cycle Manager/Vehicle Emulator Matrix Cycle/msg_count_DEBUG observer" /begin REF_MEASUREMENT msg_count_DEBUG_vem_s /end REF_MEASUREMENT /end GROUP
/begin GROUP S190_vehicle_emulator_basic_cycle_0 "HANcoder_E407_TTA_Controller_v4_5/HANcoder STM32 Target - E407-STM32 algorithm/TTA CAN System/TTA System/Matrix Cycle Manager/Vehicle Emulator Matrix Cycle/vehicle emulator basic cycle 0"
 /begin SUB_GROUP S1522_COMM_Task___Sync_bc_0 S1522_COMP_Task___Reset_Board S1522_COMP_Task___Sync_bc0_check S1522_COMP_Task___Vehicle_Emulator_Calculate_Angles /end SUB_GROUP
/end GROUP
/begin GROUP S190_vehicle_emulator_basic_cycle_1 "HANcoder_E407_TTA_Controller_v4_5/HANcoder STM32 Target - E407-STM32 algorithm/TTA CAN System/TTA System/Matrix Cycle Manager/Vehicle Emulator Matrix Cycle/vehicle emulator basic cycle 1"
 /begin SUB_GROUP S1523_COMM_Task___Output_Emulator S1523_COMM_Task___Sensor_Values S1523_COMM_Task___Sync_bc_1 S1523_COMP_Task___Rx_Output_Emulator_Check S1523_COMP_Task___Sync_bc1_check /end SUB_GROUP
/end GROUP
/begin GROUP S144_msg_decoding "HANcoder_E407_TTA_Controller_v4_5/HANcoder STM32 Target - E407-STM32 algorithm/TTA CAN System/TTA System/Initialization/RoleID and Global Time init/Global Time Initialization Slave/msg_decoding" /begin SUB_GROUP S145_Bit_Shift S145_Bit_Shift1 S145_Bit_Shift2 /end SUB_GROUP /end GROUP
/begin GROUP S191_COMM_Task___Sync_bc_0 "HANcoder_E407_TTA_Controller_v4_5/HANcoder STM32 Target - E407-STM32 algorithm/TTA CAN System/TTA System/Matrix Cycle Manager/Backup Board Matrix Cycle/Backup board basic cycle 0/COMM Task - Sync bc 0" /begin SUB_GROUP S195_Transmission_subtasks /end SUB_GROUP /end GROUP
/begin GROUP S191_COMP_Task___Sync_bc0_check "HANcoder_E407_TTA_Controller_v4_5/HANcoder STM32 Target - E407-STM32 algorithm/TTA CAN System/TTA System/Matrix Cycle Manager/Backup Board Matrix Cycle/Backup board basic cycle 0/COMP Task - Sync bc0 check" /begin SUB_GROUP S198_Process_Messages /end SUB_GROUP /end GROUP
/begin GROUP S192_COMM_Task___Sync_bc_1 "HANcoder_E407_TTA_Controller_v4_5/HANcoder STM32 Target - E407-STM32 algorithm/TTA CAN System/TTA System/Matrix Cycle Manager/Backup Board Matrix Cycle/Backup board basic cycle 1/COMM Task - Sync bc 1" /begin SUB_GROUP S271_Transmission_subtasks1 /end SUB_GROUP /end GROUP
/begin GROUP S192_COMP_Task___MF "HANcoder_E407_TTA_Controller_v4_5/HANcoder STM32 Target - E407-STM32 algorithm/TTA CAN System/TTA System/Matrix Cycle Manager/Backup Board Matrix Cycle/Backup board basic cycle 1/COMP Task - MF"
 /begin SUB_GROUP S272_MF_load_msgs_1 S272_MF_load_msgs_2 S272_MF_load_msgs_3 S272_MF_main /end SUB_GROUP
/end GROUP
/begin GROUP S192_COMP_Task___Sync_bc1_check "HANcoder_E407_TTA_Controller_v4_5/HANcoder STM32 Target - E407-STM32 algorithm/TTA CAN System/TTA System/Matrix Cycle Manager/Backup Board Matrix Cycle/Backup board basic cycle 1/COMP Task - Sync bc1 check" /begin SUB_GROUP S277_Process_Messages /end SUB_GROUP /end GROUP
/begin GROUP S545_COMM_Task___Sync_bc_0 "HANcoder_E407_TTA_Controller_v4_5/HANcoder STM32 Target - E407-STM32 algorithm/TTA CAN System/TTA System/Matrix Cycle Manager/Controller Matrix Cycle/controller basic cycle 0/COMM Task - Sync bc 0" /begin SUB_GROUP S548_Transmission_subtasks /end SUB_GROUP /end GROUP
/begin GROUP S545_COMM_Task___Vote1 "HANcoder_E407_TTA_Controller_v4_5/HANcoder STM32 Target - E407-STM32 algorithm/TTA CAN System/TTA System/Matrix Cycle Manager/Controller Matrix Cycle/controller basic cycle 0/COMM Task - Vote1" /begin SUB_GROUP S549_Transmission_subtasks /end SUB_GROUP /end GROUP
/begin GROUP S545_COMM_Task___Vote2 "HANcoder_E407_TTA_Controller_v4_5/HANcoder STM32 Target - E407-STM32 algorithm/TTA CAN System/TTA System/Matrix Cycle Manager/Controller Matrix Cycle/controller basic cycle 0/COMM Task - Vote2" /begin SUB_GROUP S550_Transmission_subtasks /end SUB_GROUP /end GROUP
/begin GROUP S545_COMM_Task___Vote3 "HANcoder_E407_TTA_Controller_v4_5/HANcoder STM32 Target - E407-STM32 algorithm/TTA CAN System/TTA System/Matrix Cycle Manager/Controller Matrix Cycle/controller basic cycle 0/COMM Task - Vote3" /begin SUB_GROUP S551_Transmission_subtasks /end SUB_GROUP /end GROUP
/begin GROUP S545_COMP_Task___Check_Timeouts "HANcoder_E407_TTA_Controller_v4_5/HANcoder STM32 Target - E407-STM32 algorithm/TTA CAN System/TTA System/Matrix Cycle Manager/Controller Matrix Cycle/controller basic cycle 0/COMP Task - Check Timeouts" /begin SUB_GROUP S552_Timeout_and_Board_error_counter /end SUB_GROUP /end GROUP
/begin GROUP S545_COMP_Task___Reset_Board "HANcoder_E407_TTA_Controller_v4_5/HANcoder STM32 Target - E407-STM32 algorithm/TTA CAN System/TTA System/Matrix Cycle Manager/Controller Matrix Cycle/controller basic cycle 0/COMP Task - Reset Board" /begin REF_MEASUREMENT reset_s /end REF_MEASUREMENT /end GROUP
/begin GROUP S545_COMP_Task___Sync_bc0_check "HANcoder_E407_TTA_Controller_v4_5/HANcoder STM32 Target - E407-STM32 algorithm/TTA CAN System/TTA System/Matrix Cycle Manager/Controller Matrix Cycle/controller basic cycle 0/COMP Task - Sync bc0 check" /begin SUB_GROUP S556_Process_Messages /end SUB_GROUP /end GROUP
/begin GROUP S545_COMP_Task___Vote_Decision "HANcoder_E407_TTA_Controller_v4_5/HANcoder STM32 Target - E407-STM32 algorithm/TTA CAN System/TTA System/Matrix Cycle Manager/Controller Matrix Cycle/controller basic cycle 0/COMP Task - Vote Decision" /begin SUB_GROUP S558_Vote_Decision /end SUB_GROUP /end GROUP
/begin GROUP S546_COMM_Task___Output_Control1 "HANcoder_E407_TTA_Controller_v4_5/HANcoder STM32 Target - E407-STM32 algorithm/TTA CAN System/TTA System/Matrix Cycle Manager/Controller Matrix Cycle/controller basic cycle 1/COMM Task - Output Control1" /begin SUB_GROUP S784_Transmission_subtasks1 /end SUB_GROUP /end GROUP
/begin GROUP S546_COMM_Task___Output_Control2 "HANcoder_E407_TTA_Controller_v4_5/HANcoder STM32 Target - E407-STM32 algorithm/TTA CAN System/TTA System/Matrix Cycle Manager/Controller Matrix Cycle/controller basic cycle 1/COMM Task - Output Control2" /begin SUB_GROUP S785_Transmission_subtasks /end SUB_GROUP /end GROUP
/begin GROUP S546_COMM_Task___Output_Control3 "HANcoder_E407_TTA_Controller_v4_5/HANcoder STM32 Target - E407-STM32 algorithm/TTA CAN System/TTA System/Matrix Cycle Manager/Controller Matrix Cycle/controller basic cycle 1/COMM Task - Output Control3" /begin SUB_GROUP S786_Transmission_subtasks /end SUB_GROUP /end GROUP
/begin GROUP S546_COMM_Task___Output_Emulator "HANcoder_E407_TTA_Controller_v4_5/HANcoder STM32 Target - E407-STM32 algorithm/TTA CAN System/TTA System/Matrix Cycle Manager/Controller Matrix Cycle/controller basic cycle 1/COMM Task - Output Emulator" /begin SUB_GROUP S787_Transmission_subtasks /end SUB_GROUP /end GROUP
/begin GROUP S546_COMM_Task___Sensor_Values "HANcoder_E407_TTA_Controller_v4_5/HANcoder STM32 Target - E407-STM32 algorithm/TTA CAN System/TTA System/Matrix Cycle Manager/Controller Matrix Cycle/controller basic cycle 1/COMM Task - Sensor_Values" /begin SUB_GROUP S788_Transmission_subtasks /end SUB_GROUP /end GROUP
/begin GROUP S546_COMM_Task___Set_Values "HANcoder_E407_TTA_Controller_v4_5/HANcoder STM32 Target - E407-STM32 algorithm/TTA CAN System/TTA System/Matrix Cycle Manager/Controller Matrix Cycle/controller basic cycle 1/COMM Task - Set_Values" /begin SUB_GROUP S789_Transmission_subtasks /end SUB_GROUP /end GROUP
/begin GROUP S546_COMM_Task___Sync_bc_1 "HANcoder_E407_TTA_Controller_v4_5/HANcoder STM32 Target - E407-STM32 algorithm/TTA CAN System/TTA System/Matrix Cycle Manager/Controller Matrix Cycle/controller basic cycle 1/COMM Task - Sync bc 1" /begin SUB_GROUP S790_Transmission_subtasks1 /end SUB_GROUP /end GROUP
/begin GROUP S546_COMP_Task___Calculate_Speed "HANcoder_E407_TTA_Controller_v4_5/HANcoder STM32 Target - E407-STM32 algorithm/TTA CAN System/TTA System/Matrix Cycle Manager/Controller Matrix Cycle/controller basic cycle 1/COMP Task - Calculate Speed" /begin SUB_GROUP S791_Calculate_speed /end SUB_GROUP /end GROUP
/begin GROUP S546_COMP_Task___Calculate_Steer "HANcoder_E407_TTA_Controller_v4_5/HANcoder STM32 Target - E407-STM32 algorithm/TTA CAN System/TTA System/Matrix Cycle Manager/Controller Matrix Cycle/controller basic cycle 1/COMP Task - Calculate Steer" /begin SUB_GROUP S792_Calculate_steering /end SUB_GROUP /end GROUP
/begin GROUP S546_COMP_Task___Calculate_Torque "HANcoder_E407_TTA_Controller_v4_5/HANcoder STM32 Target - E407-STM32 algorithm/TTA CAN System/TTA System/Matrix Cycle Manager/Controller Matrix Cycle/controller basic cycle 1/COMP Task - Calculate Torque" /begin SUB_GROUP S793_Calculate_torque /end SUB_GROUP /end GROUP
/begin GROUP S546_COMP_Task___Rx_Output_Control1_Check "HANcoder_E407_TTA_Controller_v4_5/HANcoder STM32 Target - E407-STM32 algorithm/TTA CAN System/TTA System/Matrix Cycle Manager/Controller Matrix Cycle/controller basic cycle 1/COMP Task - Rx_Output_Control1_Check" /begin SUB_GROUP S795_Process_Messages /end SUB_GROUP /end GROUP
/begin GROUP S546_COMP_Task___Rx_Output_Control2_Check "HANcoder_E407_TTA_Controller_v4_5/HANcoder STM32 Target - E407-STM32 algorithm/TTA CAN System/TTA System/Matrix Cycle Manager/Controller Matrix Cycle/controller basic cycle 1/COMP Task - Rx_Output_Control2_Check" /begin SUB_GROUP S796_Process_Messages /end SUB_GROUP /end GROUP
/begin GROUP S546_COMP_Task___Rx_Sensor_Values_Check "HANcoder_E407_TTA_Controller_v4_5/HANcoder STM32 Target - E407-STM32 algorithm/TTA CAN System/TTA System/Matrix Cycle Manager/Controller Matrix Cycle/controller basic cycle 1/COMP Task - Rx_Sensor_Values_Check" /begin SUB_GROUP S798_Update_Msg_buffer /end SUB_GROUP /end GROUP
/begin GROUP S546_COMP_Task___Rx_Set_Values_Check "HANcoder_E407_TTA_Controller_v4_5/HANcoder STM32 Target - E407-STM32 algorithm/TTA CAN System/TTA System/Matrix Cycle Manager/Controller Matrix Cycle/controller basic cycle 1/COMP Task - Rx_Set_Values_Check" /begin SUB_GROUP S799_Update_Msg_buffer /end SUB_GROUP /end GROUP
/begin GROUP S546_COMP_Task___Sync_bc1_check "HANcoder_E407_TTA_Controller_v4_5/HANcoder STM32 Target - E407-STM32 algorithm/TTA CAN System/TTA System/Matrix Cycle Manager/Controller Matrix Cycle/controller basic cycle 1/COMP Task - Sync bc1 check" /begin SUB_GROUP S800_Process_Messages /end SUB_GROUP /end GROUP
/begin GROUP S546_COMP_Task___TMR "HANcoder_E407_TTA_Controller_v4_5/HANcoder STM32 Target - E407-STM32 algorithm/TTA CAN System/TTA System/Matrix Cycle Manager/Controller Matrix Cycle/controller basic cycle 1/COMP Task - TMR" /begin SUB_GROUP S801_TMR_load_msgs_1 S801_TMR_load_msgs_2 S801_TMR_main /end SUB_GROUP /end GROUP
/begin GROUP S1339_COMM_Task___Sync_bc_0 "HANcoder_E407_TTA_Controller_v4_5/HANcoder STM32 Target - E407-STM32 algorithm/TTA CAN System/TTA System/Matrix Cycle Manager/Input Generator Matrix Cycle/input generator basic cycle 0/COMM Task - Sync bc 0" /begin SUB_GROUP S1342_Transmission_subtasks /end SUB_GROUP /end GROUP
/begin GROUP S1339_COMP_Task___Reset_Board "HANcoder_E407_TTA_Controller_v4_5/HANcoder STM32 Target - E407-STM32 algorithm/TTA CAN System/TTA System/Matrix Cycle Manager/Input Generator Matrix Cycle/input generator basic cycle 0/COMP Task - Reset Board" /begin REF_MEASUREMENT reset_ing_s /end REF_MEASUREMENT /end GROUP
/begin GROUP S1339_COMP_Task___Sync_bc0_check "HANcoder_E407_TTA_Controller_v4_5/HANcoder STM32 Target - E407-STM32 algorithm/TTA CAN System/TTA System/Matrix Cycle Manager/Input Generator Matrix Cycle/input generator basic cycle 0/COMP Task - Sync bc0 check" /begin SUB_GROUP S1345_Process_Messages /end SUB_GROUP /end GROUP
/begin GROUP S1340_COMM_Task___Set_Values "HANcoder_E407_TTA_Controller_v4_5/HANcoder STM32 Target - E407-STM32 algorithm/TTA CAN System/TTA System/Matrix Cycle Manager/Input Generator Matrix Cycle/input generator basic cycle 1/COMM Task - Set_Values" /begin SUB_GROUP S1416_Transmission_subtasks /end SUB_GROUP /end GROUP
/begin GROUP S1340_COMM_Task___Sync_bc_1 "HANcoder_E407_TTA_Controller_v4_5/HANcoder STM32 Target - E407-STM32 algorithm/TTA CAN System/TTA System/Matrix Cycle Manager/Input Generator Matrix Cycle/input generator basic cycle 1/COMM Task - Sync bc 1" /begin SUB_GROUP S1417_Transmission_subtasks /end SUB_GROUP /end GROUP
/begin GROUP S1340_COMP_Task___Sync_bc1_check "HANcoder_E407_TTA_Controller_v4_5/HANcoder STM32 Target - E407-STM32 algorithm/TTA CAN System/TTA System/Matrix Cycle Manager/Input Generator Matrix Cycle/input generator basic cycle 1/COMP Task - Sync bc1 check" /begin SUB_GROUP S1421_Process_Messages /end SUB_GROUP /end GROUP
/begin GROUP S1522_COMM_Task___Sync_bc_0 "HANcoder_E407_TTA_Controller_v4_5/HANcoder STM32 Target - E407-STM32 algorithm/TTA CAN System/TTA System/Matrix Cycle Manager/Vehicle Emulator Matrix Cycle/vehicle emulator basic cycle 0/COMM Task - Sync bc 0" /begin SUB_GROUP S1524_Transmission_subtasks /end SUB_GROUP /end GROUP
/begin GROUP S1522_COMP_Task___Reset_Board "HANcoder_E407_TTA_Controller_v4_5/HANcoder STM32 Target - E407-STM32 algorithm/TTA CAN System/TTA System/Matrix Cycle Manager/Vehicle Emulator Matrix Cycle/vehicle emulator basic cycle 0/COMP Task - Reset Board" /begin REF_MEASUREMENT reset_vem_s /end REF_MEASUREMENT /end GROUP
/begin GROUP S1522_COMP_Task___Sync_bc0_check "HANcoder_E407_TTA_Controller_v4_5/HANcoder STM32 Target - E407-STM32 algorithm/TTA CAN System/TTA System/Matrix Cycle Manager/Vehicle Emulator Matrix Cycle/vehicle emulator basic cycle 0/COMP Task - Sync bc0 check" /begin SUB_GROUP S1527_Process_Messages /end SUB_GROUP /end GROUP
/begin GROUP S1522_COMP_Task___Vehicle_Emulator_Calculate_Angles "HANcoder_E407_TTA_Controller_v4_5/HANcoder STM32 Target - E407-STM32 algorithm/TTA CAN System/TTA System/Matrix Cycle Manager/Vehicle Emulator Matrix Cycle/vehicle emulator basic cycle 0/COMP Task - Vehicle Emulator Calculate Angles" /begin SUB_GROUP S1529_Vehicle_Emulator_Calculate_Angles /end SUB_GROUP /end GROUP
/begin GROUP S1523_COMM_Task___Output_Emulator "HANcoder_E407_TTA_Controller_v4_5/HANcoder STM32 Target - E407-STM32 algorithm/TTA CAN System/TTA System/Matrix Cycle Manager/Vehicle Emulator Matrix Cycle/vehicle emulator basic cycle 1/COMM Task - Output Emulator" /begin SUB_GROUP S1611_Transmission_subtasks /end SUB_GROUP /end GROUP
/begin GROUP S1523_COMM_Task___Sensor_Values "HANcoder_E407_TTA_Controller_v4_5/HANcoder STM32 Target - E407-STM32 algorithm/TTA CAN System/TTA System/Matrix Cycle Manager/Vehicle Emulator Matrix Cycle/vehicle emulator basic cycle 1/COMM Task - Sensor_Values" /begin SUB_GROUP S1612_Transmission_subtasks /end SUB_GROUP /end GROUP
/begin GROUP S1523_COMM_Task___Sync_bc_1 "HANcoder_E407_TTA_Controller_v4_5/HANcoder STM32 Target - E407-STM32 algorithm/TTA CAN System/TTA System/Matrix Cycle Manager/Vehicle Emulator Matrix Cycle/vehicle emulator basic cycle 1/COMM Task - Sync bc 1" /begin SUB_GROUP S1613_Transmission_subtasks /end SUB_GROUP /end GROUP
/begin GROUP S1523_COMP_Task___Rx_Output_Emulator_Check "HANcoder_E407_TTA_Controller_v4_5/HANcoder STM32 Target - E407-STM32 algorithm/TTA CAN System/TTA System/Matrix Cycle Manager/Vehicle Emulator Matrix Cycle/vehicle emulator basic cycle 1/COMP Task - Rx Output Emulator Check" /begin SUB_GROUP S1615_Update_Msg_buffer /end SUB_GROUP /end GROUP
/begin GROUP S1523_COMP_Task___Sync_bc1_check "HANcoder_E407_TTA_Controller_v4_5/HANcoder STM32 Target - E407-STM32 algorithm/TTA CAN System/TTA System/Matrix Cycle Manager/Vehicle Emulator Matrix Cycle/vehicle emulator basic cycle 1/COMP Task - Sync bc1 check" /begin SUB_GROUP S1617_Process_Messages /end SUB_GROUP /end GROUP
/begin GROUP S145_Bit_Shift "HANcoder_E407_TTA_Controller_v4_5/HANcoder STM32 Target - E407-STM32 algorithm/TTA CAN System/TTA System/Initialization/RoleID and Global Time init/Global Time Initialization Slave/msg_decoding/Bit Shift" /begin REF_MEASUREMENT Rx_init_bc /end REF_MEASUREMENT /end GROUP
/begin GROUP S145_Bit_Shift1 "HANcoder_E407_TTA_Controller_v4_5/HANcoder STM32 Target - E407-STM32 algorithm/TTA CAN System/TTA System/Initialization/RoleID and Global Time init/Global Time Initialization Slave/msg_decoding/Bit Shift1" /begin REF_MEASUREMENT Rx_init_mc /end REF_MEASUREMENT /end GROUP
/begin GROUP S145_Bit_Shift2 "HANcoder_E407_TTA_Controller_v4_5/HANcoder STM32 Target - E407-STM32 algorithm/TTA CAN System/TTA System/Initialization/RoleID and Global Time init/Global Time Initialization Slave/msg_decoding/Bit Shift2" /begin REF_MEASUREMENT Rx_init_id /end REF_MEASUREMENT /end GROUP
/begin GROUP S195_Transmission_subtasks "HANcoder_E407_TTA_Controller_v4_5/HANcoder STM32 Target - E407-STM32 algorithm/TTA CAN System/TTA System/Matrix Cycle Manager/Backup Board Matrix Cycle/Backup board basic cycle 0/COMM Task - Sync bc 0/Transmission subtasks"
 /begin SUB_GROUP S201_Check_msg_transmission_CAN1 S201_Check_msg_transmission_CAN2 /end SUB_GROUP
/end GROUP
/begin GROUP S198_Process_Messages "HANcoder_E407_TTA_Controller_v4_5/HANcoder STM32 Target - E407-STM32 algorithm/TTA CAN System/TTA System/Matrix Cycle Manager/Backup Board Matrix Cycle/Backup board basic cycle 0/COMP Task - Sync bc0 check/Process_Messages" /begin SUB_GROUP S235_Desync_calculation /end SUB_GROUP /end GROUP
/begin GROUP S271_Transmission_subtasks1 "HANcoder_E407_TTA_Controller_v4_5/HANcoder STM32 Target - E407-STM32 algorithm/TTA CAN System/TTA System/Matrix Cycle Manager/Backup Board Matrix Cycle/Backup board basic cycle 1/COMM Task - Sync bc 1/Transmission subtasks1"
 /begin SUB_GROUP S287_Check_msg_transmission_CAN1 S287_Check_msg_transmission_CAN2 /end SUB_GROUP
/end GROUP
/begin GROUP S272_MF_load_msgs_1 "HANcoder_E407_TTA_Controller_v4_5/HANcoder STM32 Target - E407-STM32 algorithm/TTA CAN System/TTA System/Matrix Cycle Manager/Backup Board Matrix Cycle/Backup board basic cycle 1/COMP Task - MF/MF_load_msgs_1"
 /begin SUB_GROUP S319_uint8_2float S319_uint8_2float1 S319_uint8_2float2 S319_uint8_2float3 /end SUB_GROUP
/end GROUP
/begin GROUP S272_MF_load_msgs_2 "HANcoder_E407_TTA_Controller_v4_5/HANcoder STM32 Target - E407-STM32 algorithm/TTA CAN System/TTA System/Matrix Cycle Manager/Backup Board Matrix Cycle/Backup board basic cycle 1/COMP Task - MF/MF_load_msgs_2"
 /begin SUB_GROUP S320_uint8_2float4 S320_uint8_2float5 S320_uint8_2float6 S320_uint8_2float7 /end SUB_GROUP
/end GROUP
/begin GROUP S272_MF_load_msgs_3 "HANcoder_E407_TTA_Controller_v4_5/HANcoder STM32 Target - E407-STM32 algorithm/TTA CAN System/TTA System/Matrix Cycle Manager/Backup Board Matrix Cycle/Backup board basic cycle 1/COMP Task - MF/MF_load_msgs_3"
 /begin SUB_GROUP S321_uint8_2float4 S321_uint8_2float5 S321_uint8_2float6 S321_uint8_2float7 /end SUB_GROUP
/end GROUP
/begin GROUP S272_MF_main "HANcoder_E407_TTA_Controller_v4_5/HANcoder STM32 Target - E407-STM32 algorithm/TTA CAN System/TTA System/Matrix Cycle Manager/Backup Board Matrix Cycle/Backup board basic cycle 1/COMP Task - MF/MF_main"
 /begin SUB_GROUP S322_Agreement_between_Out1_and_out3 S322_Agreement_between_Out2_and_out3 S322_Agreement_between_out1_and_out2 /end SUB_GROUP
/end GROUP
/begin GROUP S277_Process_Messages "HANcoder_E407_TTA_Controller_v4_5/HANcoder STM32 Target - E407-STM32 algorithm/TTA CAN System/TTA System/Matrix Cycle Manager/Backup Board Matrix Cycle/Backup board basic cycle 1/COMP Task - Sync bc1 check/Process_Messages" /begin SUB_GROUP S512_Desync_calculation /end SUB_GROUP /end GROUP
/begin GROUP S548_Transmission_subtasks "HANcoder_E407_TTA_Controller_v4_5/HANcoder STM32 Target - E407-STM32 algorithm/TTA CAN System/TTA System/Matrix Cycle Manager/Controller Matrix Cycle/controller basic cycle 0/COMM Task - Sync bc 0/Transmission subtasks"
 /begin SUB_GROUP S566_Check_msg_transmission_CAN1 S566_Check_msg_transmission_CAN2 /end SUB_GROUP
/end GROUP
/begin GROUP S549_Transmission_subtasks "HANcoder_E407_TTA_Controller_v4_5/HANcoder STM32 Target - E407-STM32 algorithm/TTA CAN System/TTA System/Matrix Cycle Manager/Controller Matrix Cycle/controller basic cycle 0/COMM Task - Vote1/Transmission subtasks"
 /begin SUB_GROUP S599_Check_msg_transmission_CAN1 S599_Check_msg_transmission_CAN2 /end SUB_GROUP
/end GROUP
/begin GROUP S550_Transmission_subtasks "HANcoder_E407_TTA_Controller_v4_5/HANcoder STM32 Target - E407-STM32 algorithm/TTA CAN System/TTA System/Matrix Cycle Manager/Controller Matrix Cycle/controller basic cycle 0/COMM Task - Vote2/Transmission subtasks"
 /begin SUB_GROUP S617_Check_msg_transmission_CAN1 S617_Check_msg_transmission_CAN2 /end SUB_GROUP
/end GROUP
/begin GROUP S551_Transmission_subtasks "HANcoder_E407_TTA_Controller_v4_5/HANcoder STM32 Target - E407-STM32 algorithm/TTA CAN System/TTA System/Matrix Cycle Manager/Controller Matrix Cycle/controller basic cycle 0/COMM Task - Vote3/Transmission subtasks"
 /begin SUB_GROUP S635_Check_msg_transmission_CAN1 S635_Check_msg_transmission_CAN2 /end SUB_GROUP
/end GROUP
/begin GROUP S552_Timeout_and_Board_error_counter "HANcoder_E407_TTA_Controller_v4_5/HANcoder STM32 Target - E407-STM32 algorithm/TTA CAN System/TTA System/Matrix Cycle Manager/Controller Matrix Cycle/controller basic cycle 0/COMP Task - Check Timeouts/Timeout and Board error counter"
 /begin SUB_GROUP S652_Timeout_Counter_1_DEBUG S652_Timeout_Counter_2_DEBUG S652_Timeout_Counter_3_DEBUG /end SUB_GROUP
/end GROUP
/begin GROUP S556_Process_Messages "HANcoder_E407_TTA_Controller_v4_5/HANcoder STM32 Target - E407-STM32 algorithm/TTA CAN System/TTA System/Matrix Cycle Manager/Controller Matrix Cycle/controller basic cycle 0/COMP Task - Sync bc0 check/Process_Messages" /begin SUB_GROUP S661_Desync_calculation /end SUB_GROUP /end GROUP
/begin GROUP S558_Vote_Decision "HANcoder_E407_TTA_Controller_v4_5/HANcoder STM32 Target - E407-STM32 algorithm/TTA CAN System/TTA System/Matrix Cycle Manager/Controller Matrix Cycle/controller basic cycle 0/COMP Task - Vote Decision/Vote Decision" /begin REF_MEASUREMENT Vote_s /end REF_MEASUREMENT /end GROUP
/begin GROUP S784_Transmission_subtasks1 "HANcoder_E407_TTA_Controller_v4_5/HANcoder STM32 Target - E407-STM32 algorithm/TTA CAN System/TTA System/Matrix Cycle Manager/Controller Matrix Cycle/controller basic cycle 1/COMM Task - Output Control1/Transmission subtasks1"
 /begin SUB_GROUP S805_Check_msg_transmission_CAN1 S805_Check_msg_transmission_CAN2 /end SUB_GROUP
/end GROUP
/begin GROUP S785_Transmission_subtasks "HANcoder_E407_TTA_Controller_v4_5/HANcoder STM32 Target - E407-STM32 algorithm/TTA CAN System/TTA System/Matrix Cycle Manager/Controller Matrix Cycle/controller basic cycle 1/COMM Task - Output Control2/Transmission subtasks"
 /begin SUB_GROUP S836_Check_msg_transmission_CAN1 S836_Check_msg_transmission_CAN2 /end SUB_GROUP
/end GROUP
/begin GROUP S786_Transmission_subtasks "HANcoder_E407_TTA_Controller_v4_5/HANcoder STM32 Target - E407-STM32 algorithm/TTA CAN System/TTA System/Matrix Cycle Manager/Controller Matrix Cycle/controller basic cycle 1/COMM Task - Output Control3/Transmission subtasks"
 /begin SUB_GROUP S867_Check_msg_transmission_CAN1 S867_Check_msg_transmission_CAN2 /end SUB_GROUP
/end GROUP
/begin GROUP S787_Transmission_subtasks "HANcoder_E407_TTA_Controller_v4_5/HANcoder STM32 Target - E407-STM32 algorithm/TTA CAN System/TTA System/Matrix Cycle Manager/Controller Matrix Cycle/controller basic cycle 1/COMM Task - Output Emulator/Transmission subtasks"
 /begin SUB_GROUP S897_Check_msg_transmission_CAN1 S897_Check_msg_transmission_CAN2 /end SUB_GROUP
/end GROUP
/begin GROUP S788_Transmission_subtasks "HANcoder_E407_TTA_Controller_v4_5/HANcoder STM32 Target - E407-STM32 algorithm/TTA CAN System/TTA System/Matrix Cycle Manager/Controller Matrix Cycle/controller basic cycle 1/COMM Task - Sensor_Values/Transmission subtasks"
 /begin SUB_GROUP S927_Check_msg_transmission_CAN1 S927_Check_msg_transmission_CAN2 /end SUB_GROUP
/end GROUP
/begin GROUP S789_Transmission_subtasks "HANcoder_E407_TTA_Controller_v4_5/HANcoder STM32 Target - E407-STM32 algorithm/TTA CAN System/TTA System/Matrix Cycle Manager/Controller Matrix Cycle/controller basic cycle 1/COMM Task - Set_Values/Transmission subtasks"
 /begin SUB_GROUP S957_Check_msg_transmission_CAN1 S957_Check_msg_transmission_CAN2 S957_Msg_Value_Data_Encoded /end SUB_GROUP
/end GROUP
/begin GROUP S790_Transmission_subtasks1 "HANcoder_E407_TTA_Controller_v4_5/HANcoder STM32 Target - E407-STM32 algorithm/TTA CAN System/TTA System/Matrix Cycle Manager/Controller Matrix Cycle/controller basic cycle 1/COMM Task - Sync bc 1/Transmission subtasks1"
 /begin SUB_GROUP S984_Check_msg_transmission_CAN1 S984_Check_msg_transmission_CAN2 /end SUB_GROUP
/end GROUP
/begin GROUP S791_Calculate_speed "HANcoder_E407_TTA_Controller_v4_5/HANcoder STM32 Target - E407-STM32 algorithm/TTA CAN System/TTA System/Matrix Cycle Manager/Controller Matrix Cycle/controller basic cycle 1/COMP Task - Calculate Speed/Calculate speed" /begin SUB_GROUP S1016_Integral_speed /end SUB_GROUP /begin REF_CHARACTERISTIC speed_k_d speed_k_i speed_k_p /end REF_CHARACTERISTIC
 /begin REF_MEASUREMENT torque_al_set_s torque_ar_set_s torque_fl_set_s torque_fr_set_s v_ctreff_s v_est_s /end REF_MEASUREMENT
/end GROUP
/begin GROUP S792_Calculate_steering "HANcoder_E407_TTA_Controller_v4_5/HANcoder STM32 Target - E407-STM32 algorithm/TTA CAN System/TTA System/Matrix Cycle Manager/Controller Matrix Cycle/controller basic cycle 1/COMP Task - Calculate Steer/Calculate steering"
 /begin REF_MEASUREMENT theta_al_stored_s theta_ar_stored_s theta_fl_stored_s theta_fr_stored_s /end REF_MEASUREMENT
/end GROUP
/begin GROUP S793_Calculate_torque "HANcoder_E407_TTA_Controller_v4_5/HANcoder STM32 Target - E407-STM32 algorithm/TTA CAN System/TTA System/Matrix Cycle Manager/Controller Matrix Cycle/controller basic cycle 1/COMP Task - Calculate Torque/Calculate torque"
 /begin REF_CHARACTERISTIC torque_a_k_d torque_a_k_i torque_a_k_p torque_f_k_d torque_f_k_i torque_f_k_p /end REF_CHARACTERISTIC
/end GROUP
/begin GROUP S795_Process_Messages "HANcoder_E407_TTA_Controller_v4_5/HANcoder STM32 Target - E407-STM32 algorithm/TTA CAN System/TTA System/Matrix Cycle Manager/Controller Matrix Cycle/controller basic cycle 1/COMP Task - Rx_Output_Control1_Check/Process_Messages" /begin REF_MEASUREMENT out1_rx_s /end REF_MEASUREMENT /end GROUP
/begin GROUP S796_Process_Messages "HANcoder_E407_TTA_Controller_v4_5/HANcoder STM32 Target - E407-STM32 algorithm/TTA CAN System/TTA System/Matrix Cycle Manager/Controller Matrix Cycle/controller basic cycle 1/COMP Task - Rx_Output_Control2_Check/Process_Messages" /begin REF_MEASUREMENT out2_rx_s /end REF_MEASUREMENT /end GROUP
/begin GROUP S798_Update_Msg_buffer "HANcoder_E407_TTA_Controller_v4_5/HANcoder STM32 Target - E407-STM32 algorithm/TTA CAN System/TTA System/Matrix Cycle Manager/Controller Matrix Cycle/controller basic cycle 1/COMP Task - Rx_Sensor_Values_Check/Update Msg buffer" /begin SUB_GROUP S1121_Sensor_Values_Rx_Update /end SUB_GROUP /begin REF_MEASUREMENT mc_counter_s new_sensor_rx_s /end REF_MEASUREMENT /end GROUP
/begin GROUP S799_Update_Msg_buffer "HANcoder_E407_TTA_Controller_v4_5/HANcoder STM32 Target - E407-STM32 algorithm/TTA CAN System/TTA System/Matrix Cycle Manager/Controller Matrix Cycle/controller basic cycle 1/COMP Task - Rx_Set_Values_Check/Update Msg buffer" /begin REF_MEASUREMENT new_set_rx_s /end REF_MEASUREMENT /end GROUP
/begin GROUP S800_Process_Messages "HANcoder_E407_TTA_Controller_v4_5/HANcoder STM32 Target - E407-STM32 algorithm/TTA CAN System/TTA System/Matrix Cycle Manager/Controller Matrix Cycle/controller basic cycle 1/COMP Task - Sync bc1 check/Process_Messages" /begin SUB_GROUP S1218_Desync_calculation /end SUB_GROUP /end GROUP
/begin GROUP S801_TMR_load_msgs_1 "HANcoder_E407_TTA_Controller_v4_5/HANcoder STM32 Target - E407-STM32 algorithm/TTA CAN System/TTA System/Matrix Cycle Manager/Controller Matrix Cycle/controller basic cycle 1/COMP Task - TMR/TMR_load_msgs_1"
 /begin SUB_GROUP S1247_uint8_2float S1247_uint8_2float1 S1247_uint8_2float2 S1247_uint8_2float3 /end SUB_GROUP
/end GROUP
/begin GROUP S801_TMR_load_msgs_2 "HANcoder_E407_TTA_Controller_v4_5/HANcoder STM32 Target - E407-STM32 algorithm/TTA CAN System/TTA System/Matrix Cycle Manager/Controller Matrix Cycle/controller basic cycle 1/COMP Task - TMR/TMR_load_msgs_2"
 /begin SUB_GROUP S1248_uint8_2float4 S1248_uint8_2float5 S1248_uint8_2float6 S1248_uint8_2float7 /end SUB_GROUP
/end GROUP
/begin GROUP S801_TMR_main "HANcoder_E407_TTA_Controller_v4_5/HANcoder STM32 Target - E407-STM32 algorithm/TTA CAN System/TTA System/Matrix Cycle Manager/Controller Matrix Cycle/controller basic cycle 1/COMP Task - TMR/TMR_main"
 /begin REF_MEASUREMENT TMR_miss1_sensor TMR_miss1_set TMR_miss2_sensor TMR_miss2_set TMR_miss_out1 TMR_miss_out2 TMR_miss_sensor TMR_miss_set error_log1_s error_log2_s error_log3_s tau_al1_disagree_s tau_al2_disagree_s tau_al_disagree_s tau_ar1_disagree_s tau_ar2_disagree_s tau_ar_disagree_s tau_fl1_disagree_s tau_fl2_disagree_s tau_fl_disagree_s tau_fr1_disagree_s tau_fr2_disagree_s tau_fr_disagree_s torque_al_set_out_s torque_ar_set_out_s torque_fl_set_out_s torque_fr_set_out_s /end REF_MEASUREMENT
/end GROUP
/begin GROUP S1342_Transmission_subtasks "HANcoder_E407_TTA_Controller_v4_5/HANcoder STM32 Target - E407-STM32 algorithm/TTA CAN System/TTA System/Matrix Cycle Manager/Input Generator Matrix Cycle/input generator basic cycle 0/COMM Task - Sync bc 0/Transmission subtasks"
 /begin SUB_GROUP S1348_Check_msg_transmission_CAN1 S1348_Check_msg_transmission_CAN2 /end SUB_GROUP
/end GROUP
/begin GROUP S1345_Process_Messages "HANcoder_E407_TTA_Controller_v4_5/HANcoder STM32 Target - E407-STM32 algorithm/TTA CAN System/TTA System/Matrix Cycle Manager/Input Generator Matrix Cycle/input generator basic cycle 0/COMP Task - Sync bc0 check/Process_Messages" /begin SUB_GROUP S1383_Desync_calculation /end SUB_GROUP /end GROUP
/begin GROUP S1416_Transmission_subtasks "HANcoder_E407_TTA_Controller_v4_5/HANcoder STM32 Target - E407-STM32 algorithm/TTA CAN System/TTA System/Matrix Cycle Manager/Input Generator Matrix Cycle/input generator basic cycle 1/COMM Task - Set_Values/Transmission subtasks"
 /begin SUB_GROUP S1424_Check_msg_transmission_CAN1 S1424_Check_msg_transmission_CAN2 S1424_Msg_Value_Data_Encoded /end SUB_GROUP
/end GROUP
/begin GROUP S1417_Transmission_subtasks "HANcoder_E407_TTA_Controller_v4_5/HANcoder STM32 Target - E407-STM32 algorithm/TTA CAN System/TTA System/Matrix Cycle Manager/Input Generator Matrix Cycle/input generator basic cycle 1/COMM Task - Sync bc 1/Transmission subtasks"
 /begin SUB_GROUP S1451_Check_msg_transmission_CAN1 S1451_Check_msg_transmission_CAN2 /end SUB_GROUP
/end GROUP
/begin GROUP S1421_Process_Messages "HANcoder_E407_TTA_Controller_v4_5/HANcoder STM32 Target - E407-STM32 algorithm/TTA CAN System/TTA System/Matrix Cycle Manager/Input Generator Matrix Cycle/input generator basic cycle 1/COMP Task - Sync bc1 check/Process_Messages" /begin SUB_GROUP S1487_Desync_calculation /end SUB_GROUP /end GROUP
/begin GROUP S1524_Transmission_subtasks "HANcoder_E407_TTA_Controller_v4_5/HANcoder STM32 Target - E407-STM32 algorithm/TTA CAN System/TTA System/Matrix Cycle Manager/Vehicle Emulator Matrix Cycle/vehicle emulator basic cycle 0/COMM Task - Sync bc 0/Transmission subtasks"
 /begin SUB_GROUP S1533_Check_msg_transmission_CAN1 S1533_Check_msg_transmission_CAN2 /end SUB_GROUP
/end GROUP
/begin GROUP S1527_Process_Messages "HANcoder_E407_TTA_Controller_v4_5/HANcoder STM32 Target - E407-STM32 algorithm/TTA CAN System/TTA System/Matrix Cycle Manager/Vehicle Emulator Matrix Cycle/vehicle emulator basic cycle 0/COMP Task - Sync bc0 check/Process_Messages" /begin SUB_GROUP S1568_Desync_calculation /end SUB_GROUP /end GROUP
/begin GROUP S1529_Vehicle_Emulator_Calculate_Angles "HANcoder_E407_TTA_Controller_v4_5/HANcoder STM32 Target - E407-STM32 algorithm/TTA CAN System/TTA System/Matrix Cycle Manager/Vehicle Emulator Matrix Cycle/vehicle emulator basic cycle 0/COMP Task - Vehicle Emulator Calculate Angles/Vehicle Emulator Calculate Angles"
 /begin SUB_GROUP S1601_Integral_theta_aft_left S1601_Integral_theta_aft_right S1601_Integral_theta_front_left S1601_Integral_theta_front_right /end SUB_GROUP
 /begin REF_MEASUREMENT v_est_vem_s /end REF_MEASUREMENT
/end GROUP
/begin GROUP S1611_Transmission_subtasks "HANcoder_E407_TTA_Controller_v4_5/HANcoder STM32 Target - E407-STM32 algorithm/TTA CAN System/TTA System/Matrix Cycle Manager/Vehicle Emulator Matrix Cycle/vehicle emulator basic cycle 1/COMM Task - Output Emulator/Transmission subtasks"
 /begin SUB_GROUP S1620_Check_msg_transmission_CAN1 S1620_Check_msg_transmission_CAN2 /end SUB_GROUP
/end GROUP
/begin GROUP S1612_Transmission_subtasks "HANcoder_E407_TTA_Controller_v4_5/HANcoder STM32 Target - E407-STM32 algorithm/TTA CAN System/TTA System/Matrix Cycle Manager/Vehicle Emulator Matrix Cycle/vehicle emulator basic cycle 1/COMM Task - Sensor_Values/Transmission subtasks"
 /begin SUB_GROUP S1650_Check_msg_transmission_CAN1 S1650_Check_msg_transmission_CAN2 /end SUB_GROUP
/end GROUP
/begin GROUP S1613_Transmission_subtasks "HANcoder_E407_TTA_Controller_v4_5/HANcoder STM32 Target - E407-STM32 algorithm/TTA CAN System/TTA System/Matrix Cycle Manager/Vehicle Emulator Matrix Cycle/vehicle emulator basic cycle 1/COMM Task - Sync bc 1/Transmission subtasks"
 /begin SUB_GROUP S1680_Check_msg_transmission_CAN1 S1680_Check_msg_transmission_CAN2 /end SUB_GROUP
/end GROUP
/begin GROUP S1615_Update_Msg_buffer "HANcoder_E407_TTA_Controller_v4_5/HANcoder STM32 Target - E407-STM32 algorithm/TTA CAN System/TTA System/Matrix Cycle Manager/Vehicle Emulator Matrix Cycle/vehicle emulator basic cycle 1/COMP Task - Rx Output Emulator Check/Update Msg buffer" /begin REF_MEASUREMENT new_sensor_rx_vem_s /end REF_MEASUREMENT /end GROUP
/begin GROUP S1617_Process_Messages "HANcoder_E407_TTA_Controller_v4_5/HANcoder STM32 Target - E407-STM32 algorithm/TTA CAN System/TTA System/Matrix Cycle Manager/Vehicle Emulator Matrix Cycle/vehicle emulator basic cycle 1/COMP Task - Sync bc1 check/Process_Messages" /begin SUB_GROUP S1766_Desync_calculation /end SUB_GROUP /end GROUP
/begin GROUP S201_Check_msg_transmission_CAN1 "HANcoder_E407_TTA_Controller_v4_5/HANcoder STM32 Target - E407-STM32 algorithm/TTA CAN System/TTA System/Matrix Cycle Manager/Backup Board Matrix Cycle/Backup board basic cycle 0/COMM Task - Sync bc 0/Transmission subtasks/Check msg transmission CAN1" /begin REF_CHARACTERISTIC COMM_Phase1 COMM_Phase_init1 /end REF_CHARACTERISTIC /end GROUP
/begin GROUP S201_Check_msg_transmission_CAN2 "HANcoder_E407_TTA_Controller_v4_5/HANcoder STM32 Target - E407-STM32 algorithm/TTA CAN System/TTA System/Matrix Cycle Manager/Backup Board Matrix Cycle/Backup board basic cycle 0/COMM Task - Sync bc 0/Transmission subtasks/Check msg transmission CAN2" /begin REF_CHARACTERISTIC COMM_Phase2 COMM_Phase_init2 /end REF_CHARACTERISTIC /end GROUP
/begin GROUP S235_Desync_calculation "HANcoder_E407_TTA_Controller_v4_5/HANcoder STM32 Target - E407-STM32 algorithm/TTA CAN System/TTA System/Matrix Cycle Manager/Backup Board Matrix Cycle/Backup board basic cycle 0/COMP Task - Sync bc0 check/Process_Messages/Desync calculation" /begin REF_CHARACTERISTIC COMM_Phase1 COMM_Phase2 /end REF_CHARACTERISTIC /end GROUP
/begin GROUP S287_Check_msg_transmission_CAN1 "HANcoder_E407_TTA_Controller_v4_5/HANcoder STM32 Target - E407-STM32 algorithm/TTA CAN System/TTA System/Matrix Cycle Manager/Backup Board Matrix Cycle/Backup board basic cycle 1/COMM Task - Sync bc 1/Transmission subtasks1/Check msg transmission CAN1" /begin REF_CHARACTERISTIC COMM_Phase1 COMM_Phase_init1 /end REF_CHARACTERISTIC /end GROUP
/begin GROUP S287_Check_msg_transmission_CAN2 "HANcoder_E407_TTA_Controller_v4_5/HANcoder STM32 Target - E407-STM32 algorithm/TTA CAN System/TTA System/Matrix Cycle Manager/Backup Board Matrix Cycle/Backup board basic cycle 1/COMM Task - Sync bc 1/Transmission subtasks1/Check msg transmission CAN2" /begin REF_CHARACTERISTIC COMM_Phase2 COMM_Phase_init2 /end REF_CHARACTERISTIC /end GROUP
/begin GROUP S319_uint8_2float "HANcoder_E407_TTA_Controller_v4_5/HANcoder STM32 Target - E407-STM32 algorithm/TTA CAN System/TTA System/Matrix Cycle Manager/Backup Board Matrix Cycle/Backup board basic cycle 1/COMP Task - MF/MF_load_msgs_1/uint8_2float" /begin REF_MEASUREMENT torque_fr_out1_bb /end REF_MEASUREMENT /end GROUP
/begin GROUP S319_uint8_2float1 "HANcoder_E407_TTA_Controller_v4_5/HANcoder STM32 Target - E407-STM32 algorithm/TTA CAN System/TTA System/Matrix Cycle Manager/Backup Board Matrix Cycle/Backup board basic cycle 1/COMP Task - MF/MF_load_msgs_1/uint8_2float1" /begin REF_MEASUREMENT torque_fl_out1_bb /end REF_MEASUREMENT /end GROUP
/begin GROUP S319_uint8_2float2 "HANcoder_E407_TTA_Controller_v4_5/HANcoder STM32 Target - E407-STM32 algorithm/TTA CAN System/TTA System/Matrix Cycle Manager/Backup Board Matrix Cycle/Backup board basic cycle 1/COMP Task - MF/MF_load_msgs_1/uint8_2float2" /begin REF_MEASUREMENT torque_ar_out1_bb /end REF_MEASUREMENT /end GROUP
/begin GROUP S319_uint8_2float3 "HANcoder_E407_TTA_Controller_v4_5/HANcoder STM32 Target - E407-STM32 algorithm/TTA CAN System/TTA System/Matrix Cycle Manager/Backup Board Matrix Cycle/Backup board basic cycle 1/COMP Task - MF/MF_load_msgs_1/uint8_2float3" /begin REF_MEASUREMENT torque_al_out1_bb /end REF_MEASUREMENT /end GROUP
/begin GROUP S320_uint8_2float4 "HANcoder_E407_TTA_Controller_v4_5/HANcoder STM32 Target - E407-STM32 algorithm/TTA CAN System/TTA System/Matrix Cycle Manager/Backup Board Matrix Cycle/Backup board basic cycle 1/COMP Task - MF/MF_load_msgs_2/uint8_2float4" /begin REF_MEASUREMENT torque_fr_out2_bb /end REF_MEASUREMENT /end GROUP
/begin GROUP S320_uint8_2float5 "HANcoder_E407_TTA_Controller_v4_5/HANcoder STM32 Target - E407-STM32 algorithm/TTA CAN System/TTA System/Matrix Cycle Manager/Backup Board Matrix Cycle/Backup board basic cycle 1/COMP Task - MF/MF_load_msgs_2/uint8_2float5" /begin REF_MEASUREMENT torque_fl_out2_bb /end REF_MEASUREMENT /end GROUP
/begin GROUP S320_uint8_2float6 "HANcoder_E407_TTA_Controller_v4_5/HANcoder STM32 Target - E407-STM32 algorithm/TTA CAN System/TTA System/Matrix Cycle Manager/Backup Board Matrix Cycle/Backup board basic cycle 1/COMP Task - MF/MF_load_msgs_2/uint8_2float6" /begin REF_MEASUREMENT torque_ar_out2_bb /end REF_MEASUREMENT /end GROUP
/begin GROUP S320_uint8_2float7 "HANcoder_E407_TTA_Controller_v4_5/HANcoder STM32 Target - E407-STM32 algorithm/TTA CAN System/TTA System/Matrix Cycle Manager/Backup Board Matrix Cycle/Backup board basic cycle 1/COMP Task - MF/MF_load_msgs_2/uint8_2float7" /begin REF_MEASUREMENT torque_al_out2_bb /end REF_MEASUREMENT /end GROUP
/begin GROUP S321_uint8_2float4 "HANcoder_E407_TTA_Controller_v4_5/HANcoder STM32 Target - E407-STM32 algorithm/TTA CAN System/TTA System/Matrix Cycle Manager/Backup Board Matrix Cycle/Backup board basic cycle 1/COMP Task - MF/MF_load_msgs_3/uint8_2float4" /begin REF_MEASUREMENT torque_fr_out3_bb /end REF_MEASUREMENT /end GROUP
/begin GROUP S321_uint8_2float5 "HANcoder_E407_TTA_Controller_v4_5/HANcoder STM32 Target - E407-STM32 algorithm/TTA CAN System/TTA System/Matrix Cycle Manager/Backup Board Matrix Cycle/Backup board basic cycle 1/COMP Task - MF/MF_load_msgs_3/uint8_2float5" /begin REF_MEASUREMENT torque_fl_out3_bb /end REF_MEASUREMENT /end GROUP
/begin GROUP S321_uint8_2float6 "HANcoder_E407_TTA_Controller_v4_5/HANcoder STM32 Target - E407-STM32 algorithm/TTA CAN System/TTA System/Matrix Cycle Manager/Backup Board Matrix Cycle/Backup board basic cycle 1/COMP Task - MF/MF_load_msgs_3/uint8_2float6" /begin REF_MEASUREMENT torque_ar_out3_bb /end REF_MEASUREMENT /end GROUP
/begin GROUP S321_uint8_2float7 "HANcoder_E407_TTA_Controller_v4_5/HANcoder STM32 Target - E407-STM32 algorithm/TTA CAN System/TTA System/Matrix Cycle Manager/Backup Board Matrix Cycle/Backup board basic cycle 1/COMP Task - MF/MF_load_msgs_3/uint8_2float7" /begin REF_MEASUREMENT torque_al_out3_bb /end REF_MEASUREMENT /end GROUP
/begin GROUP S322_Agreement_between_Out1_and_out3 "HANcoder_E407_TTA_Controller_v4_5/HANcoder STM32 Target - E407-STM32 algorithm/TTA CAN System/TTA System/Matrix Cycle Manager/Backup Board Matrix Cycle/Backup board basic cycle 1/COMP Task - MF/MF_main/Agreement between Out1 and out3" /begin REF_MEASUREMENT tau_fr_out13_agree /end REF_MEASUREMENT /end GROUP
/begin GROUP S322_Agreement_between_Out2_and_out3 "HANcoder_E407_TTA_Controller_v4_5/HANcoder STM32 Target - E407-STM32 algorithm/TTA CAN System/TTA System/Matrix Cycle Manager/Backup Board Matrix Cycle/Backup board basic cycle 1/COMP Task - MF/MF_main/Agreement between Out2 and out3" /begin REF_MEASUREMENT tau_fr_out23_agree /end REF_MEASUREMENT /end GROUP
/begin GROUP S322_Agreement_between_out1_and_out2 "HANcoder_E407_TTA_Controller_v4_5/HANcoder STM32 Target - E407-STM32 algorithm/TTA CAN System/TTA System/Matrix Cycle Manager/Backup Board Matrix Cycle/Backup board basic cycle 1/COMP Task - MF/MF_main/Agreement between out1 and out2" /begin REF_MEASUREMENT tau_fr_out12_agree /end REF_MEASUREMENT /end GROUP
/begin GROUP S512_Desync_calculation "HANcoder_E407_TTA_Controller_v4_5/HANcoder STM32 Target - E407-STM32 algorithm/TTA CAN System/TTA System/Matrix Cycle Manager/Backup Board Matrix Cycle/Backup board basic cycle 1/COMP Task - Sync bc1 check/Process_Messages/Desync calculation" /begin REF_CHARACTERISTIC COMM_Phase1 COMM_Phase2 /end REF_CHARACTERISTIC /end GROUP
/begin GROUP S566_Check_msg_transmission_CAN1 "HANcoder_E407_TTA_Controller_v4_5/HANcoder STM32 Target - E407-STM32 algorithm/TTA CAN System/TTA System/Matrix Cycle Manager/Controller Matrix Cycle/controller basic cycle 0/COMM Task - Sync bc 0/Transmission subtasks/Check msg transmission CAN1" /begin REF_CHARACTERISTIC COMM_Phase1 COMM_Phase_init1 /end REF_CHARACTERISTIC /end GROUP
/begin GROUP S566_Check_msg_transmission_CAN2 "HANcoder_E407_TTA_Controller_v4_5/HANcoder STM32 Target - E407-STM32 algorithm/TTA CAN System/TTA System/Matrix Cycle Manager/Controller Matrix Cycle/controller basic cycle 0/COMM Task - Sync bc 0/Transmission subtasks/Check msg transmission CAN2" /begin REF_CHARACTERISTIC COMM_Phase2 COMM_Phase_init2 /end REF_CHARACTERISTIC /end GROUP
/begin GROUP S599_Check_msg_transmission_CAN1 "HANcoder_E407_TTA_Controller_v4_5/HANcoder STM32 Target - E407-STM32 algorithm/TTA CAN System/TTA System/Matrix Cycle Manager/Controller Matrix Cycle/controller basic cycle 0/COMM Task - Vote1/Transmission subtasks/Check msg transmission CAN1" /begin REF_CHARACTERISTIC COMM_Phase1 COMM_Phase_init1 /end REF_CHARACTERISTIC /end GROUP
/begin GROUP S599_Check_msg_transmission_CAN2 "HANcoder_E407_TTA_Controller_v4_5/HANcoder STM32 Target - E407-STM32 algorithm/TTA CAN System/TTA System/Matrix Cycle Manager/Controller Matrix Cycle/controller basic cycle 0/COMM Task - Vote1/Transmission subtasks/Check msg transmission CAN2" /begin REF_CHARACTERISTIC COMM_Phase2 COMM_Phase_init2 /end REF_CHARACTERISTIC /end GROUP
/begin GROUP S617_Check_msg_transmission_CAN1 "HANcoder_E407_TTA_Controller_v4_5/HANcoder STM32 Target - E407-STM32 algorithm/TTA CAN System/TTA System/Matrix Cycle Manager/Controller Matrix Cycle/controller basic cycle 0/COMM Task - Vote2/Transmission subtasks/Check msg transmission CAN1" /begin REF_CHARACTERISTIC COMM_Phase1 COMM_Phase_init1 /end REF_CHARACTERISTIC /end GROUP
/begin GROUP S617_Check_msg_transmission_CAN2 "HANcoder_E407_TTA_Controller_v4_5/HANcoder STM32 Target - E407-STM32 algorithm/TTA CAN System/TTA System/Matrix Cycle Manager/Controller Matrix Cycle/controller basic cycle 0/COMM Task - Vote2/Transmission subtasks/Check msg transmission CAN2" /begin REF_CHARACTERISTIC COMM_Phase2 COMM_Phase_init2 /end REF_CHARACTERISTIC /end GROUP
/begin GROUP S635_Check_msg_transmission_CAN1 "HANcoder_E407_TTA_Controller_v4_5/HANcoder STM32 Target - E407-STM32 algorithm/TTA CAN System/TTA System/Matrix Cycle Manager/Controller Matrix Cycle/controller basic cycle 0/COMM Task - Vote3/Transmission subtasks/Check msg transmission CAN1" /begin REF_CHARACTERISTIC COMM_Phase1 COMM_Phase_init1 /end REF_CHARACTERISTIC /end GROUP
/begin GROUP S635_Check_msg_transmission_CAN2 "HANcoder_E407_TTA_Controller_v4_5/HANcoder STM32 Target - E407-STM32 algorithm/TTA CAN System/TTA System/Matrix Cycle Manager/Controller Matrix Cycle/controller basic cycle 0/COMM Task - Vote3/Transmission subtasks/Check msg transmission CAN2" /begin REF_CHARACTERISTIC COMM_Phase2 COMM_Phase_init2 /end REF_CHARACTERISTIC /end GROUP
/begin GROUP S652_Timeout_Counter_1_DEBUG "HANcoder_E407_TTA_Controller_v4_5/HANcoder STM32 Target - E407-STM32 algorithm/TTA CAN System/TTA System/Matrix Cycle Manager/Controller Matrix Cycle/controller basic cycle 0/COMP Task - Check Timeouts/Timeout and Board error counter/Timeout Counter 1 DEBUG" /begin REF_MEASUREMENT TM1_timeout_counter_s /end REF_MEASUREMENT /end GROUP
/begin GROUP S652_Timeout_Counter_2_DEBUG "HANcoder_E407_TTA_Controller_v4_5/HANcoder STM32 Target - E407-STM32 algorithm/TTA CAN System/TTA System/Matrix Cycle Manager/Controller Matrix Cycle/controller basic cycle 0/COMP Task - Check Timeouts/Timeout and Board error counter/Timeout Counter 2 DEBUG" /begin REF_MEASUREMENT TM2_timeout_counter_s /end REF_MEASUREMENT /end GROUP
/begin GROUP S652_Timeout_Counter_3_DEBUG "HANcoder_E407_TTA_Controller_v4_5/HANcoder STM32 Target - E407-STM32 algorithm/TTA CAN System/TTA System/Matrix Cycle Manager/Controller Matrix Cycle/controller basic cycle 0/COMP Task - Check Timeouts/Timeout and Board error counter/Timeout Counter 3 DEBUG" /begin REF_MEASUREMENT TM3_timeout_counter_s /end REF_MEASUREMENT /end GROUP
/begin GROUP S661_Desync_calculation "HANcoder_E407_TTA_Controller_v4_5/HANcoder STM32 Target - E407-STM32 algorithm/TTA CAN System/TTA System/Matrix Cycle Manager/Controller Matrix Cycle/controller basic cycle 0/COMP Task - Sync bc0 check/Process_Messages/Desync calculation" /begin REF_CHARACTERISTIC COMM_Phase1 COMM_Phase2 /end REF_CHARACTERISTIC /begin REF_MEASUREMENT Desync_Sync_bc0_s /end REF_MEASUREMENT /end GROUP
/begin GROUP S805_Check_msg_transmission_CAN1 "HANcoder_E407_TTA_Controller_v4_5/HANcoder STM32 Target - E407-STM32 algorithm/TTA CAN System/TTA System/Matrix Cycle Manager/Controller Matrix Cycle/controller basic cycle 1/COMM Task - Output Control1/Transmission subtasks1/Check msg transmission CAN1" /begin REF_CHARACTERISTIC COMM_Phase1 COMM_Phase_init1 /end REF_CHARACTERISTIC /end GROUP
/begin GROUP S805_Check_msg_transmission_CAN2 "HANcoder_E407_TTA_Controller_v4_5/HANcoder STM32 Target - E407-STM32 algorithm/TTA CAN System/TTA System/Matrix Cycle Manager/Controller Matrix Cycle/controller basic cycle 1/COMM Task - Output Control1/Transmission subtasks1/Check msg transmission CAN2" /begin REF_CHARACTERISTIC COMM_Phase2 COMM_Phase_init2 /end REF_CHARACTERISTIC /end GROUP
/begin GROUP S836_Check_msg_transmission_CAN1 "HANcoder_E407_TTA_Controller_v4_5/HANcoder STM32 Target - E407-STM32 algorithm/TTA CAN System/TTA System/Matrix Cycle Manager/Controller Matrix Cycle/controller basic cycle 1/COMM Task - Output Control2/Transmission subtasks/Check msg transmission CAN1" /begin REF_CHARACTERISTIC COMM_Phase1 COMM_Phase_init1 /end REF_CHARACTERISTIC /end GROUP
/begin GROUP S836_Check_msg_transmission_CAN2 "HANcoder_E407_TTA_Controller_v4_5/HANcoder STM32 Target - E407-STM32 algorithm/TTA CAN System/TTA System/Matrix Cycle Manager/Controller Matrix Cycle/controller basic cycle 1/COMM Task - Output Control2/Transmission subtasks/Check msg transmission CAN2" /begin REF_CHARACTERISTIC COMM_Phase2 COMM_Phase_init2 /end REF_CHARACTERISTIC /end GROUP
/begin GROUP S867_Check_msg_transmission_CAN1 "HANcoder_E407_TTA_Controller_v4_5/HANcoder STM32 Target - E407-STM32 algorithm/TTA CAN System/TTA System/Matrix Cycle Manager/Controller Matrix Cycle/controller basic cycle 1/COMM Task - Output Control3/Transmission subtasks/Check msg transmission CAN1" /begin REF_CHARACTERISTIC COMM_Phase1 COMM_Phase_init1 /end REF_CHARACTERISTIC /end GROUP
/begin GROUP S867_Check_msg_transmission_CAN2 "HANcoder_E407_TTA_Controller_v4_5/HANcoder STM32 Target - E407-STM32 algorithm/TTA CAN System/TTA System/Matrix Cycle Manager/Controller Matrix Cycle/controller basic cycle 1/COMM Task - Output Control3/Transmission subtasks/Check msg transmission CAN2" /begin REF_CHARACTERISTIC COMM_Phase2 COMM_Phase_init2 /end REF_CHARACTERISTIC /end GROUP
/begin GROUP S897_Check_msg_transmission_CAN1 "HANcoder_E407_TTA_Controller_v4_5/HANcoder STM32 Target - E407-STM32 algorithm/TTA CAN System/TTA System/Matrix Cycle Manager/Controller Matrix Cycle/controller basic cycle 1/COMM Task - Output Emulator/Transmission subtasks/Check msg transmission CAN1" /begin REF_CHARACTERISTIC COMM_Phase1 COMM_Phase_init1 /end REF_CHARACTERISTIC /end GROUP
/begin GROUP S897_Check_msg_transmission_CAN2 "HANcoder_E407_TTA_Controller_v4_5/HANcoder STM32 Target - E407-STM32 algorithm/TTA CAN System/TTA System/Matrix Cycle Manager/Controller Matrix Cycle/controller basic cycle 1/COMM Task - Output Emulator/Transmission subtasks/Check msg transmission CAN2" /begin REF_CHARACTERISTIC COMM_Phase2 COMM_Phase_init2 /end REF_CHARACTERISTIC /end GROUP
/begin GROUP S927_Check_msg_transmission_CAN1 "HANcoder_E407_TTA_Controller_v4_5/HANcoder STM32 Target - E407-STM32 algorithm/TTA CAN System/TTA System/Matrix Cycle Manager/Controller Matrix Cycle/controller basic cycle 1/COMM Task - Sensor_Values/Transmission subtasks/Check msg transmission CAN1" /begin REF_CHARACTERISTIC COMM_Phase1 COMM_Phase_init1 /end REF_CHARACTERISTIC /end GROUP
/begin GROUP S927_Check_msg_transmission_CAN2 "HANcoder_E407_TTA_Controller_v4_5/HANcoder STM32 Target - E407-STM32 algorithm/TTA CAN System/TTA System/Matrix Cycle Manager/Controller Matrix Cycle/controller basic cycle 1/COMM Task - Sensor_Values/Transmission subtasks/Check msg transmission CAN2" /begin REF_CHARACTERISTIC COMM_Phase2 COMM_Phase_init2 /end REF_CHARACTERISTIC /end GROUP
/begin GROUP S957_Check_msg_transmission_CAN1 "HANcoder_E407_TTA_Controller_v4_5/HANcoder STM32 Target - E407-STM32 algorithm/TTA CAN System/TTA System/Matrix Cycle Manager/Controller Matrix Cycle/controller basic cycle 1/COMM Task - Set_Values/Transmission subtasks/Check msg transmission CAN1" /begin REF_CHARACTERISTIC COMM_Phase1 COMM_Phase_init1 /end REF_CHARACTERISTIC /end GROUP
/begin GROUP S957_Check_msg_transmission_CAN2 "HANcoder_E407_TTA_Controller_v4_5/HANcoder STM32 Target - E407-STM32 algorithm/TTA CAN System/TTA System/Matrix Cycle Manager/Controller Matrix Cycle/controller basic cycle 1/COMM Task - Set_Values/Transmission subtasks/Check msg transmission CAN2" /begin REF_CHARACTERISTIC COMM_Phase2 COMM_Phase_init2 /end REF_CHARACTERISTIC /end GROUP
/begin GROUP S957_Msg_Value_Data_Encoded "HANcoder_E407_TTA_Controller_v4_5/HANcoder STM32 Target - E407-STM32 algorithm/TTA CAN System/TTA System/Matrix Cycle Manager/Controller Matrix Cycle/controller basic cycle 1/COMM Task - Set_Values/Transmission subtasks/Msg_Value_Data_Encoded" /begin REF_CHARACTERISTIC delta_a_set delta_f_set v_set /end REF_CHARACTERISTIC /end GROUP
/begin GROUP S984_Check_msg_transmission_CAN1 "HANcoder_E407_TTA_Controller_v4_5/HANcoder STM32 Target - E407-STM32 algorithm/TTA CAN System/TTA System/Matrix Cycle Manager/Controller Matrix Cycle/controller basic cycle 1/COMM Task - Sync bc 1/Transmission subtasks1/Check msg transmission CAN1" /begin REF_CHARACTERISTIC COMM_Phase1 COMM_Phase_init1 /end REF_CHARACTERISTIC /end GROUP
/begin GROUP S984_Check_msg_transmission_CAN2 "HANcoder_E407_TTA_Controller_v4_5/HANcoder STM32 Target - E407-STM32 algorithm/TTA CAN System/TTA System/Matrix Cycle Manager/Controller Matrix Cycle/controller basic cycle 1/COMM Task - Sync bc 1/Transmission subtasks1/Check msg transmission CAN2" /begin REF_CHARACTERISTIC COMM_Phase2 COMM_Phase_init2 /end REF_CHARACTERISTIC /end GROUP
/begin GROUP S1016_Integral_speed "HANcoder_E407_TTA_Controller_v4_5/HANcoder STM32 Target - E407-STM32 algorithm/TTA CAN System/TTA System/Matrix Cycle Manager/Controller Matrix Cycle/controller basic cycle 1/COMP Task - Calculate Speed/Calculate speed/Integral speed" /begin REF_MEASUREMENT v_integral_s /end REF_MEASUREMENT /end GROUP
/begin GROUP S1121_Sensor_Values_Rx_Update "HANcoder_E407_TTA_Controller_v4_5/HANcoder STM32 Target - E407-STM32 algorithm/TTA CAN System/TTA System/Matrix Cycle Manager/Controller Matrix Cycle/controller basic cycle 1/COMP Task - Rx_Sensor_Values_Check/Update Msg buffer/Sensor Values Rx Update" /begin SUB_GROUP S1148_Inputs_Rx_OK /end SUB_GROUP /end GROUP
/begin GROUP S1218_Desync_calculation "HANcoder_E407_TTA_Controller_v4_5/HANcoder STM32 Target - E407-STM32 algorithm/TTA CAN System/TTA System/Matrix Cycle Manager/Controller Matrix Cycle/controller basic cycle 1/COMP Task - Sync bc1 check/Process_Messages/Desync calculation" /begin REF_CHARACTERISTIC COMM_Phase1 COMM_Phase2 /end REF_CHARACTERISTIC /begin REF_MEASUREMENT Desync_Sync_bc1_s /end REF_MEASUREMENT /end GROUP
/begin GROUP S1247_uint8_2float "HANcoder_E407_TTA_Controller_v4_5/HANcoder STM32 Target - E407-STM32 algorithm/TTA CAN System/TTA System/Matrix Cycle Manager/Controller Matrix Cycle/controller basic cycle 1/COMP Task - TMR/TMR_load_msgs_1/uint8_2float" /begin REF_MEASUREMENT torque_fr_out1_s /end REF_MEASUREMENT /end GROUP
/begin GROUP S1247_uint8_2float1 "HANcoder_E407_TTA_Controller_v4_5/HANcoder STM32 Target - E407-STM32 algorithm/TTA CAN System/TTA System/Matrix Cycle Manager/Controller Matrix Cycle/controller basic cycle 1/COMP Task - TMR/TMR_load_msgs_1/uint8_2float1" /begin REF_MEASUREMENT torque_fl_out1_s /end REF_MEASUREMENT /end GROUP
/begin GROUP S1247_uint8_2float2 "HANcoder_E407_TTA_Controller_v4_5/HANcoder STM32 Target - E407-STM32 algorithm/TTA CAN System/TTA System/Matrix Cycle Manager/Controller Matrix Cycle/controller basic cycle 1/COMP Task - TMR/TMR_load_msgs_1/uint8_2float2" /begin REF_MEASUREMENT torque_ar_out1_s /end REF_MEASUREMENT /end GROUP
/begin GROUP S1247_uint8_2float3 "HANcoder_E407_TTA_Controller_v4_5/HANcoder STM32 Target - E407-STM32 algorithm/TTA CAN System/TTA System/Matrix Cycle Manager/Controller Matrix Cycle/controller basic cycle 1/COMP Task - TMR/TMR_load_msgs_1/uint8_2float3" /begin REF_MEASUREMENT torque_al_out1_s /end REF_MEASUREMENT /end GROUP
/begin GROUP S1248_uint8_2float4 "HANcoder_E407_TTA_Controller_v4_5/HANcoder STM32 Target - E407-STM32 algorithm/TTA CAN System/TTA System/Matrix Cycle Manager/Controller Matrix Cycle/controller basic cycle 1/COMP Task - TMR/TMR_load_msgs_2/uint8_2float4" /begin REF_MEASUREMENT torque_fr_out2_s /end REF_MEASUREMENT /end GROUP
/begin GROUP S1248_uint8_2float5 "HANcoder_E407_TTA_Controller_v4_5/HANcoder STM32 Target - E407-STM32 algorithm/TTA CAN System/TTA System/Matrix Cycle Manager/Controller Matrix Cycle/controller basic cycle 1/COMP Task - TMR/TMR_load_msgs_2/uint8_2float5" /begin REF_MEASUREMENT torque_fl_out2_s /end REF_MEASUREMENT /end GROUP
/begin GROUP S1248_uint8_2float6 "HANcoder_E407_TTA_Controller_v4_5/HANcoder STM32 Target - E407-STM32 algorithm/TTA CAN System/TTA System/Matrix Cycle Manager/Controller Matrix Cycle/controller basic cycle 1/COMP Task - TMR/TMR_load_msgs_2/uint8_2float6" /begin REF_MEASUREMENT torque_ar_out2_s /end REF_MEASUREMENT /end GROUP
/begin GROUP S1248_uint8_2float7 "HANcoder_E407_TTA_Controller_v4_5/HANcoder STM32 Target - E407-STM32 algorithm/TTA CAN System/TTA System/Matrix Cycle Manager/Controller Matrix Cycle/controller basic cycle 1/COMP Task - TMR/TMR_load_msgs_2/uint8_2float7" /begin REF_MEASUREMENT torque_al_out2_s /end REF_MEASUREMENT /end GROUP
/begin GROUP S1348_Check_msg_transmission_CAN1 "HANcoder_E407_TTA_Controller_v4_5/HANcoder STM32 Target - E407-STM32 algorithm/TTA CAN System/TTA System/Matrix Cycle Manager/Input Generator Matrix Cycle/input generator basic cycle 0/COMM Task - Sync bc 0/Transmission subtasks/Check msg transmission CAN1" /begin REF_CHARACTERISTIC COMM_Phase1 COMM_Phase_init1 /end REF_CHARACTERISTIC /end GROUP
/begin GROUP S1348_Check_msg_transmission_CAN2 "HANcoder_E407_TTA_Controller_v4_5/HANcoder STM32 Target - E407-STM32 algorithm/TTA CAN System/TTA System/Matrix Cycle Manager/Input Generator Matrix Cycle/input generator basic cycle 0/COMM Task - Sync bc 0/Transmission subtasks/Check msg transmission CAN2" /begin REF_CHARACTERISTIC COMM_Phase2 COMM_Phase_init2 /end REF_CHARACTERISTIC /end GROUP
/begin GROUP S1383_Desync_calculation "HANcoder_E407_TTA_Controller_v4_5/HANcoder STM32 Target - E407-STM32 algorithm/TTA CAN System/TTA System/Matrix Cycle Manager/Input Generator Matrix Cycle/input generator basic cycle 0/COMP Task - Sync bc0 check/Process_Messages/Desync calculation" /begin REF_CHARACTERISTIC COMM_Phase1 COMM_Phase2 /end REF_CHARACTERISTIC /begin REF_MEASUREMENT Desync_Sync_bc0_ing_s /end REF_MEASUREMENT /end GROUP
/begin GROUP S1424_Check_msg_transmission_CAN1 "HANcoder_E407_TTA_Controller_v4_5/HANcoder STM32 Target - E407-STM32 algorithm/TTA CAN System/TTA System/Matrix Cycle Manager/Input Generator Matrix Cycle/input generator basic cycle 1/COMM Task - Set_Values/Transmission subtasks/Check msg transmission CAN1" /begin REF_CHARACTERISTIC COMM_Phase1 COMM_Phase_init1 /end REF_CHARACTERISTIC /end GROUP
/begin GROUP S1424_Check_msg_transmission_CAN2 "HANcoder_E407_TTA_Controller_v4_5/HANcoder STM32 Target - E407-STM32 algorithm/TTA CAN System/TTA System/Matrix Cycle Manager/Input Generator Matrix Cycle/input generator basic cycle 1/COMM Task - Set_Values/Transmission subtasks/Check msg transmission CAN2" /begin REF_CHARACTERISTIC COMM_Phase2 COMM_Phase_init2 /end REF_CHARACTERISTIC /end GROUP
/begin GROUP S1424_Msg_Value_Data_Encoded "HANcoder_E407_TTA_Controller_v4_5/HANcoder STM32 Target - E407-STM32 algorithm/TTA CAN System/TTA System/Matrix Cycle Manager/Input Generator Matrix Cycle/input generator basic cycle 1/COMM Task - Set_Values/Transmission subtasks/Msg_Value_Data_Encoded" /begin REF_CHARACTERISTIC delta_a_set delta_f_set v_set /end REF_CHARACTERISTIC /begin REF_MEASUREMENT v_set_s /end REF_MEASUREMENT /end GROUP
/begin GROUP S1451_Check_msg_transmission_CAN1 "HANcoder_E407_TTA_Controller_v4_5/HANcoder STM32 Target - E407-STM32 algorithm/TTA CAN System/TTA System/Matrix Cycle Manager/Input Generator Matrix Cycle/input generator basic cycle 1/COMM Task - Sync bc 1/Transmission subtasks/Check msg transmission CAN1" /begin REF_CHARACTERISTIC COMM_Phase1 COMM_Phase_init1 /end REF_CHARACTERISTIC /end GROUP
/begin GROUP S1451_Check_msg_transmission_CAN2 "HANcoder_E407_TTA_Controller_v4_5/HANcoder STM32 Target - E407-STM32 algorithm/TTA CAN System/TTA System/Matrix Cycle Manager/Input Generator Matrix Cycle/input generator basic cycle 1/COMM Task - Sync bc 1/Transmission subtasks/Check msg transmission CAN2" /begin REF_CHARACTERISTIC COMM_Phase2 COMM_Phase_init2 /end REF_CHARACTERISTIC /end GROUP
/begin GROUP S1487_Desync_calculation "HANcoder_E407_TTA_Controller_v4_5/HANcoder STM32 Target - E407-STM32 algorithm/TTA CAN System/TTA System/Matrix Cycle Manager/Input Generator Matrix Cycle/input generator basic cycle 1/COMP Task - Sync bc1 check/Process_Messages/Desync calculation" /begin REF_CHARACTERISTIC COMM_Phase1 COMM_Phase2 /end REF_CHARACTERISTIC /begin REF_MEASUREMENT Desync_Sync_bc1_ing_s /end REF_MEASUREMENT /end GROUP
/begin GROUP S1533_Check_msg_transmission_CAN1 "HANcoder_E407_TTA_Controller_v4_5/HANcoder STM32 Target - E407-STM32 algorithm/TTA CAN System/TTA System/Matrix Cycle Manager/Vehicle Emulator Matrix Cycle/vehicle emulator basic cycle 0/COMM Task - Sync bc 0/Transmission subtasks/Check msg transmission CAN1" /begin REF_CHARACTERISTIC COMM_Phase1 COMM_Phase_init1 /end REF_CHARACTERISTIC /end GROUP
/begin GROUP S1533_Check_msg_transmission_CAN2 "HANcoder_E407_TTA_Controller_v4_5/HANcoder STM32 Target - E407-STM32 algorithm/TTA CAN System/TTA System/Matrix Cycle Manager/Vehicle Emulator Matrix Cycle/vehicle emulator basic cycle 0/COMM Task - Sync bc 0/Transmission subtasks/Check msg transmission CAN2" /begin REF_CHARACTERISTIC COMM_Phase2 COMM_Phase_init2 /end REF_CHARACTERISTIC /end GROUP
/begin GROUP S1568_Desync_calculation "HANcoder_E407_TTA_Controller_v4_5/HANcoder STM32 Target - E407-STM32 algorithm/TTA CAN System/TTA System/Matrix Cycle Manager/Vehicle Emulator Matrix Cycle/vehicle emulator basic cycle 0/COMP Task - Sync bc0 check/Process_Messages/Desync calculation" /begin REF_CHARACTERISTIC COMM_Phase1 COMM_Phase2 /end REF_CHARACTERISTIC /begin REF_MEASUREMENT Desync_Sync_bc0_vem_s /end REF_MEASUREMENT /end GROUP
/begin GROUP S1601_Integral_theta_aft_left "HANcoder_E407_TTA_Controller_v4_5/HANcoder STM32 Target - E407-STM32 algorithm/TTA CAN System/TTA System/Matrix Cycle Manager/Vehicle Emulator Matrix Cycle/vehicle emulator basic cycle 0/COMP Task - Vehicle Emulator Calculate Angles/Vehicle Emulator Calculate Angles/Integral theta aft left" /begin REF_MEASUREMENT theta_al_s /end REF_MEASUREMENT /end GROUP
/begin GROUP S1601_Integral_theta_aft_right "HANcoder_E407_TTA_Controller_v4_5/HANcoder STM32 Target - E407-STM32 algorithm/TTA CAN System/TTA System/Matrix Cycle Manager/Vehicle Emulator Matrix Cycle/vehicle emulator basic cycle 0/COMP Task - Vehicle Emulator Calculate Angles/Vehicle Emulator Calculate Angles/Integral theta aft right" /begin REF_MEASUREMENT theta_ar_s /end REF_MEASUREMENT /end GROUP
/begin GROUP S1601_Integral_theta_front_left "HANcoder_E407_TTA_Controller_v4_5/HANcoder STM32 Target - E407-STM32 algorithm/TTA CAN System/TTA System/Matrix Cycle Manager/Vehicle Emulator Matrix Cycle/vehicle emulator basic cycle 0/COMP Task - Vehicle Emulator Calculate Angles/Vehicle Emulator Calculate Angles/Integral theta front left" /begin REF_MEASUREMENT theta_fl_s /end REF_MEASUREMENT /end GROUP
/begin GROUP S1601_Integral_theta_front_right "HANcoder_E407_TTA_Controller_v4_5/HANcoder STM32 Target - E407-STM32 algorithm/TTA CAN System/TTA System/Matrix Cycle Manager/Vehicle Emulator Matrix Cycle/vehicle emulator basic cycle 0/COMP Task - Vehicle Emulator Calculate Angles/Vehicle Emulator Calculate Angles/Integral theta front right" /begin REF_MEASUREMENT theta_fr_s /end REF_MEASUREMENT /end GROUP
/begin GROUP S1620_Check_msg_transmission_CAN1 "HANcoder_E407_TTA_Controller_v4_5/HANcoder STM32 Target - E407-STM32 algorithm/TTA CAN System/TTA System/Matrix Cycle Manager/Vehicle Emulator Matrix Cycle/vehicle emulator basic cycle 1/COMM Task - Output Emulator/Transmission subtasks/Check msg transmission CAN1" /begin REF_CHARACTERISTIC COMM_Phase1 COMM_Phase_init1 /end REF_CHARACTERISTIC /end GROUP
/begin GROUP S1620_Check_msg_transmission_CAN2 "HANcoder_E407_TTA_Controller_v4_5/HANcoder STM32 Target - E407-STM32 algorithm/TTA CAN System/TTA System/Matrix Cycle Manager/Vehicle Emulator Matrix Cycle/vehicle emulator basic cycle 1/COMM Task - Output Emulator/Transmission subtasks/Check msg transmission CAN2" /begin REF_CHARACTERISTIC COMM_Phase2 COMM_Phase_init2 /end REF_CHARACTERISTIC /end GROUP
/begin GROUP S1650_Check_msg_transmission_CAN1 "HANcoder_E407_TTA_Controller_v4_5/HANcoder STM32 Target - E407-STM32 algorithm/TTA CAN System/TTA System/Matrix Cycle Manager/Vehicle Emulator Matrix Cycle/vehicle emulator basic cycle 1/COMM Task - Sensor_Values/Transmission subtasks/Check msg transmission CAN1" /begin REF_CHARACTERISTIC COMM_Phase1 COMM_Phase_init1 /end REF_CHARACTERISTIC /end GROUP
/begin GROUP S1650_Check_msg_transmission_CAN2 "HANcoder_E407_TTA_Controller_v4_5/HANcoder STM32 Target - E407-STM32 algorithm/TTA CAN System/TTA System/Matrix Cycle Manager/Vehicle Emulator Matrix Cycle/vehicle emulator basic cycle 1/COMM Task - Sensor_Values/Transmission subtasks/Check msg transmission CAN2" /begin REF_CHARACTERISTIC COMM_Phase2 COMM_Phase_init2 /end REF_CHARACTERISTIC /end GROUP
/begin GROUP S1680_Check_msg_transmission_CAN1 "HANcoder_E407_TTA_Controller_v4_5/HANcoder STM32 Target - E407-STM32 algorithm/TTA CAN System/TTA System/Matrix Cycle Manager/Vehicle Emulator Matrix Cycle/vehicle emulator basic cycle 1/COMM Task - Sync bc 1/Transmission subtasks/Check msg transmission CAN1" /begin REF_CHARACTERISTIC COMM_Phase1 COMM_Phase_init1 /end REF_CHARACTERISTIC /end GROUP
/begin GROUP S1680_Check_msg_transmission_CAN2 "HANcoder_E407_TTA_Controller_v4_5/HANcoder STM32 Target - E407-STM32 algorithm/TTA CAN System/TTA System/Matrix Cycle Manager/Vehicle Emulator Matrix Cycle/vehicle emulator basic cycle 1/COMM Task - Sync bc 1/Transmission subtasks/Check msg transmission CAN2" /begin REF_CHARACTERISTIC COMM_Phase2 COMM_Phase_init2 /end REF_CHARACTERISTIC /end GROUP
/begin GROUP S1766_Desync_calculation "HANcoder_E407_TTA_Controller_v4_5/HANcoder STM32 Target - E407-STM32 algorithm/TTA CAN System/TTA System/Matrix Cycle Manager/Vehicle Emulator Matrix Cycle/vehicle emulator basic cycle 1/COMP Task - Sync bc1 check/Process_Messages/Desync calculation" /begin REF_CHARACTERISTIC COMM_Phase1 COMM_Phase2 /end REF_CHARACTERISTIC /begin REF_MEASUREMENT Desync_Sync_bc1_vem_s /end REF_MEASUREMENT /end GROUP
/begin GROUP S1148_Inputs_Rx_OK "HANcoder_E407_TTA_Controller_v4_5/HANcoder STM32 Target - E407-STM32 algorithm/TTA CAN System/TTA System/Matrix Cycle Manager/Controller Matrix Cycle/controller basic cycle 1/COMP Task - Rx_Sensor_Values_Check/Update Msg buffer/Sensor Values Rx Update/Inputs Rx OK" /begin REF_MEASUREMENT rx_data_incr_time_s /end REF_MEASUREMENT /end GROUP
/end MODULE
/end PROJECT
/* (add any file trailer comments here) */
/* EOF HANcoder_E407_TTA_Controller_v4_5.a2l */

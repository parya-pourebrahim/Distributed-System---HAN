/******************************************************************************
* ASAP2 file: HANcoder_E407_2xCAN_TEST.a2l
* Academic License - for use in teaching, academic research, and meeting
* course requirements at degree granting institutions only. Not for
* government, commercial, or other organizational use.
* Code generation for model "HANcoder_E407_2xCAN_TEST".
* Model version : 1.120
* Simulink Coder version : 9.0 (R2018b) 24-May-2018
* C source code generated on : Tue Feb 15 08:50:12 2022
* Target selection: ert.tlc
* Embedded hardware selection: Generic->32-bit Embedded Processor
* Code generation objectives: Unspecified
* Validation result: Not run
* (add additional file header information here)
******************************************************************************/ ASAP2_VERSION 1 31
/* Version 1.31 */
/begin PROJECT ProjectName "HANcoder_E407_2xCAN_TEST_softwareID_v1_150222_085011"
/begin HEADER "Header Comments go here" /end HEADER
/begin MODULE ModuleName "Module Comment Goes Here"
/begin MOD_PAR "MOD PAR Comment Goes Here" ADDR_EPK 0x0800c008 CPU_TYPE "STM32F407" ECU "E407" EPK "HANcoder_E407_2xCAN_TEST_softwareID_v1_150222_085011"
 SYSTEM_CONSTANT "XcpStationID string length" "0x00000034"
 SYSTEM_CONSTANT "RAM-FlashOffset" "-402553760" /end MOD_PAR
/begin MOD_COMMON "Mod Common Comment Here" BYTE_ORDER MSB_LAST /end MOD_COMMON
/begin RECORD_LAYOUT Scalar_BOOLEAN FNC_VALUES 1 UBYTE COLUMN_DIR DIRECT /end RECORD_LAYOUT
/begin RECORD_LAYOUT Scalar_UBYTE FNC_VALUES 1 UBYTE COLUMN_DIR DIRECT /end RECORD_LAYOUT
/begin RECORD_LAYOUT Scalar_BYTE FNC_VALUES 1 SBYTE COLUMN_DIR DIRECT /end RECORD_LAYOUT
/begin RECORD_LAYOUT Scalar_UWORD FNC_VALUES 1 UWORD COLUMN_DIR DIRECT /end RECORD_LAYOUT
/begin RECORD_LAYOUT Scalar_SWORD FNC_VALUES 1 SWORD COLUMN_DIR DIRECT /end RECORD_LAYOUT
/begin RECORD_LAYOUT Scalar_ULONG FNC_VALUES 1 ULONG COLUMN_DIR DIRECT /end RECORD_LAYOUT
/begin RECORD_LAYOUT Scalar_LONG FNC_VALUES 1 SLONG COLUMN_DIR DIRECT /end RECORD_LAYOUT
/begin RECORD_LAYOUT Scalar_FLOAT32_IEEE FNC_VALUES 1 FLOAT32_IEEE COLUMN_DIR DIRECT /end RECORD_LAYOUT
/begin RECORD_LAYOUT Scalar_FLOAT64_IEEE FNC_VALUES 1 FLOAT64_IEEE COLUMN_DIR DIRECT /end RECORD_LAYOUT
/begin RECORD_LAYOUT Lookup1D_BYTE FNC_VALUES 1 SBYTE COLUMN_DIR DIRECT /end RECORD_LAYOUT
/begin RECORD_LAYOUT Lookup1D_X_BYTE AXIS_PTS_X 1 SBYTE INDEX_INCR DIRECT /end RECORD_LAYOUT
/begin RECORD_LAYOUT Lookup1D_UBYTE FNC_VALUES 1 UBYTE COLUMN_DIR DIRECT /end RECORD_LAYOUT
/begin RECORD_LAYOUT Lookup1D_X_UBYTE AXIS_PTS_X 1 UBYTE INDEX_INCR DIRECT /end RECORD_LAYOUT
/begin RECORD_LAYOUT Lookup1D_UWORD FNC_VALUES 1 UWORD COLUMN_DIR DIRECT /end RECORD_LAYOUT
/begin RECORD_LAYOUT Lookup1D_X_UWORD AXIS_PTS_X 1 UWORD INDEX_INCR DIRECT /end RECORD_LAYOUT
/begin RECORD_LAYOUT Lookup1D_WORD FNC_VALUES 1 SWORD COLUMN_DIR DIRECT /end RECORD_LAYOUT
/begin RECORD_LAYOUT Lookup1D_X_WORD AXIS_PTS_X 1 SWORD INDEX_INCR DIRECT /end RECORD_LAYOUT
/begin RECORD_LAYOUT Lookup1D_ULONG FNC_VALUES 1 ULONG COLUMN_DIR DIRECT /end RECORD_LAYOUT
/begin RECORD_LAYOUT Lookup1D_X_ULONG AXIS_PTS_X 1 ULONG INDEX_INCR DIRECT /end RECORD_LAYOUT
/begin RECORD_LAYOUT Lookup1D_SLONG FNC_VALUES 1 SLONG COLUMN_DIR DIRECT /end RECORD_LAYOUT
/begin RECORD_LAYOUT Lookup1D_X_LONG AXIS_PTS_X 1 SLONG INDEX_INCR DIRECT /end RECORD_LAYOUT
/begin RECORD_LAYOUT Lookup1D_FLOAT32_IEEE FNC_VALUES 1 FLOAT32_IEEE COLUMN_DIR DIRECT /end RECORD_LAYOUT
/begin RECORD_LAYOUT Lookup1D_X_FLOAT32_IEEE AXIS_PTS_X 1 FLOAT32_IEEE INDEX_INCR DIRECT /end RECORD_LAYOUT
/begin RECORD_LAYOUT Lookup1D_FLOAT64_IEEE FNC_VALUES 1 FLOAT64_IEEE COLUMN_DIR DIRECT /end RECORD_LAYOUT
/begin RECORD_LAYOUT Lookup1D_X_FLOAT64_IEEE AXIS_PTS_X 1 FLOAT64_IEEE INDEX_INCR DIRECT /end RECORD_LAYOUT
/begin RECORD_LAYOUT Lookup2D_UBYTE FNC_VALUES 1 UBYTE COLUMN_DIR DIRECT /end RECORD_LAYOUT
/begin RECORD_LAYOUT Lookup2D_X_UBYTE AXIS_PTS_X 1 UBYTE INDEX_INCR DIRECT /end RECORD_LAYOUT
/begin RECORD_LAYOUT Lookup2D_BYTE FNC_VALUES 1 SBYTE COLUMN_DIR DIRECT /end RECORD_LAYOUT
/begin RECORD_LAYOUT Lookup2D_X_BYTE AXIS_PTS_X 1 SBYTE INDEX_INCR DIRECT /end RECORD_LAYOUT
/begin RECORD_LAYOUT Lookup2D_UWORD FNC_VALUES 1 UWORD COLUMN_DIR DIRECT /end RECORD_LAYOUT
/begin RECORD_LAYOUT Lookup2D_X_UWORD AXIS_PTS_X 1 UWORD INDEX_INCR DIRECT /end RECORD_LAYOUT
/begin RECORD_LAYOUT Lookup2D_WORD FNC_VALUES 1 SWORD COLUMN_DIR DIRECT /end RECORD_LAYOUT
/begin RECORD_LAYOUT Lookup2D_X_WORD AXIS_PTS_X 1 SWORD INDEX_INCR DIRECT /end RECORD_LAYOUT
/begin RECORD_LAYOUT Lookup2D_ULONG FNC_VALUES 1 ULONG COLUMN_DIR DIRECT /end RECORD_LAYOUT
/begin RECORD_LAYOUT Lookup2D_X_ULONG AXIS_PTS_X 1 ULONG INDEX_INCR DIRECT /end RECORD_LAYOUT
/begin RECORD_LAYOUT Lookup2D_LONG FNC_VALUES 1 SLONG COLUMN_DIR DIRECT /end RECORD_LAYOUT
/begin RECORD_LAYOUT Lookup2D_X_LONG AXIS_PTS_X 1 SLONG INDEX_INCR DIRECT /end RECORD_LAYOUT
/begin RECORD_LAYOUT Lookup2D_FLOAT32_IEEE FNC_VALUES 1 FLOAT32_IEEE COLUMN_DIR DIRECT /end RECORD_LAYOUT
/begin RECORD_LAYOUT Lookup2D_X_FLOAT32_IEEE AXIS_PTS_X 1 FLOAT32_IEEE INDEX_INCR DIRECT /end RECORD_LAYOUT
/begin RECORD_LAYOUT Lookup2D_FLOAT64_IEEE FNC_VALUES 1 FLOAT64_IEEE COLUMN_DIR DIRECT /end RECORD_LAYOUT
/begin RECORD_LAYOUT Lookup2D_X_FLOAT64_IEEE AXIS_PTS_X 1 FLOAT64_IEEE INDEX_INCR DIRECT /end RECORD_LAYOUT
/begin CHARACTERISTIC HANtuneOverride /* Long Identifier */ "" /* Type */ VALUE /* ECU Address */ 0x20000003 /* Record Layout */ Scalar_BOOLEAN /* Maximum Difference */ 0 /* Conversion Method */ HANcoder_E407_2xCAN_TEST_CM_boolean /* Lower Limit */ 0 /* Upper Limit */ 1 /end CHARACTERISTIC
/begin MEASUREMENT SI_FreeHeap "" ULONG HANcoder_E407_2xCAN_TEST_CM_uint32 0 0 0 4294967295 ECU_ADDRESS 0x2000b610 /end MEASUREMENT
/begin MEASUREMENT SI_FreeStack "" ULONG HANcoder_E407_2xCAN_TEST_CM_uint32 0 0 0 4294967295 ECU_ADDRESS 0x2000b61c /end MEASUREMENT
/begin MEASUREMENT RX_MSG_2 "" ULONG HANcoder_E407_2xCAN_TEST_CM_uint32 0 0 0 4294967295 ECU_ADDRESS 0x2000b618 /end MEASUREMENT
/begin MEASUREMENT RX_MSG_1 "" ULONG HANcoder_E407_2xCAN_TEST_CM_uint32 0 0 0 4294967295 ECU_ADDRESS 0x2000b624 /end MEASUREMENT
/begin MEASUREMENT TX_MSG "" ULONG HANcoder_E407_2xCAN_TEST_CM_uint32 0 0 0 4294967295 ECU_ADDRESS 0x2000b60c /end MEASUREMENT
/begin MEASUREMENT TX_MSG_1 "" ULONG HANcoder_E407_2xCAN_TEST_CM_uint32 0 0 0 4294967295 ECU_ADDRESS 0x2000b608 /end MEASUREMENT
/begin MEASUREMENT TX_MSG_2 "" ULONG HANcoder_E407_2xCAN_TEST_CM_uint32 0 0 0 4294967295 ECU_ADDRESS 0x2000b62c /end MEASUREMENT
/begin MEASUREMENT SI_CPUload "" UBYTE HANcoder_E407_2xCAN_TEST_CM_uint8 0 0 0 255 ECU_ADDRESS 0x2000b621 /end MEASUREMENT
/begin MEASUREMENT WKUP_button "" UBYTE HANcoder_E407_2xCAN_TEST_CM_boolean 0 0 0 1 ECU_ADDRESS 0x2000b628 /end MEASUREMENT
/begin MEASUREMENT sender_id "" UBYTE HANcoder_E407_2xCAN_TEST_CM_boolean 0 0 0 1 ECU_ADDRESS 0x2000b629 /end MEASUREMENT
/begin MEASUREMENT LedValue "" UBYTE HANcoder_E407_2xCAN_TEST_CM_boolean 0 0 0 1 ECU_ADDRESS 0x2000b614 /end MEASUREMENT
/begin MEASUREMENT receiver_id "" UBYTE HANcoder_E407_2xCAN_TEST_CM_boolean 0 0 0 1 ECU_ADDRESS 0x2000b5f0 /end MEASUREMENT
/begin COMPU_METHOD HANcoder_E407_2xCAN_TEST_CM_boolean "Q = V" RAT_FUNC "%1.0" "" COEFFS 0 1 0 0 0 1 /end COMPU_METHOD
/begin COMPU_METHOD HANcoder_E407_2xCAN_TEST_CM_uint32 "Q = V" RAT_FUNC "%10.0" "" COEFFS 0 1 0 0 0 1 /end COMPU_METHOD
/begin COMPU_METHOD HANcoder_E407_2xCAN_TEST_CM_uint8 "Q = V" RAT_FUNC "%3.0" "" COEFFS 0 1 0 0 0 1 /end COMPU_METHOD
/begin GROUP HANcoder_E407_2xCAN_TEST "HANcoder_E407_2xCAN_TEST" /* Root */ ROOT /begin SUB_GROUP Root_HANcoder_STM32_Target___E407_STM32_algorithm /end SUB_GROUP /end GROUP
/begin GROUP Root_HANcoder_STM32_Target___E407_STM32_algorithm "HANcoder_E407_2xCAN_TEST/HANcoder STM32 Target - E407-STM32 algorithm"
 /begin SUB_GROUP S1_Algorithm S1_Digital_Input S1_Digital_Input1 S1_If_Action_Subsystem S1_Inputs S1_Subsystem S1_System_information /end SUB_GROUP
/end GROUP
/begin GROUP S1_Algorithm "HANcoder_E407_2xCAN_TEST/HANcoder STM32 Target - E407-STM32 algorithm/Algorithm" /begin REF_CHARACTERISTIC HANtuneOverride /end REF_CHARACTERISTIC /begin REF_MEASUREMENT LedValue /end REF_MEASUREMENT /end GROUP
/begin GROUP S1_Digital_Input "HANcoder_E407_2xCAN_TEST/HANcoder STM32 Target - E407-STM32 algorithm/Digital Input" /begin REF_MEASUREMENT sender_id /end REF_MEASUREMENT /end GROUP
/begin GROUP S1_Digital_Input1 "HANcoder_E407_2xCAN_TEST/HANcoder STM32 Target - E407-STM32 algorithm/Digital Input1" /begin REF_MEASUREMENT receiver_id /end REF_MEASUREMENT /end GROUP
/begin GROUP S1_If_Action_Subsystem "HANcoder_E407_2xCAN_TEST/HANcoder STM32 Target - E407-STM32 algorithm/If Action Subsystem" /begin REF_MEASUREMENT TX_MSG TX_MSG_1 TX_MSG_2 /end REF_MEASUREMENT /end GROUP
/begin GROUP S1_Inputs "HANcoder_E407_2xCAN_TEST/HANcoder STM32 Target - E407-STM32 algorithm/Inputs" /begin SUB_GROUP S9_Digital_Input /end SUB_GROUP /end GROUP
/begin GROUP S1_Subsystem "HANcoder_E407_2xCAN_TEST/HANcoder STM32 Target - E407-STM32 algorithm/Subsystem" /begin SUB_GROUP S11_CAN_receive S11_CAN_receive1 /end SUB_GROUP /end GROUP
/begin GROUP S1_System_information "HANcoder_E407_2xCAN_TEST/HANcoder STM32 Target - E407-STM32 algorithm/System information" /begin SUB_GROUP S12_Get_CPU_load S12_Get_free_Heap S12_Get_free_Stack /end SUB_GROUP /end GROUP
/begin GROUP S9_Digital_Input "HANcoder_E407_2xCAN_TEST/HANcoder STM32 Target - E407-STM32 algorithm/Inputs/Digital Input" /begin REF_MEASUREMENT WKUP_button /end REF_MEASUREMENT /end GROUP
/begin GROUP S11_CAN_receive "HANcoder_E407_2xCAN_TEST/HANcoder STM32 Target - E407-STM32 algorithm/Subsystem/CAN receive" /begin SUB_GROUP S28_Enabled_Subsystem /end SUB_GROUP /end GROUP
/begin GROUP S11_CAN_receive1 "HANcoder_E407_2xCAN_TEST/HANcoder STM32 Target - E407-STM32 algorithm/Subsystem/CAN receive1" /begin SUB_GROUP S29_Enabled_Subsystem /end SUB_GROUP /end GROUP
/begin GROUP S12_Get_CPU_load "HANcoder_E407_2xCAN_TEST/HANcoder STM32 Target - E407-STM32 algorithm/System information/Get CPU load" /begin REF_MEASUREMENT SI_CPUload /end REF_MEASUREMENT /end GROUP
/begin GROUP S12_Get_free_Heap "HANcoder_E407_2xCAN_TEST/HANcoder STM32 Target - E407-STM32 algorithm/System information/Get free Heap" /begin REF_MEASUREMENT SI_FreeHeap /end REF_MEASUREMENT /end GROUP
/begin GROUP S12_Get_free_Stack "HANcoder_E407_2xCAN_TEST/HANcoder STM32 Target - E407-STM32 algorithm/System information/Get free Stack" /begin REF_MEASUREMENT SI_FreeStack /end REF_MEASUREMENT /end GROUP
/begin GROUP S28_Enabled_Subsystem "HANcoder_E407_2xCAN_TEST/HANcoder STM32 Target - E407-STM32 algorithm/Subsystem/CAN receive/Enabled Subsystem" /begin REF_MEASUREMENT RX_MSG_1 /end REF_MEASUREMENT /end GROUP
/begin GROUP S29_Enabled_Subsystem "HANcoder_E407_2xCAN_TEST/HANcoder STM32 Target - E407-STM32 algorithm/Subsystem/CAN receive1/Enabled Subsystem" /begin REF_MEASUREMENT RX_MSG_2 /end REF_MEASUREMENT /end GROUP
/end MODULE
/end PROJECT
/* (add any file trailer comments here) */
/* EOF HANcoder_E407_2xCAN_TEST.a2l */
